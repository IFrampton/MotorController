/******************************************************************************
* ASAP2 file: P2319ASW01.a2l
* Code generation for model "P2319ASW01".
* Model version : 1.229
* Simulink Coder version : 9.8 (R2022b) 13-May-2022
* C source code generated on : Mon Jul 15 12:16:08 2024
* Target selection: ert.tlc
* Embedded hardware selection: NXP->Cortex-M4
* Code generation objectives: Unspecified
* Validation result: Not run
* (add additional file header information here)
******************************************************************************/ ASAP2_VERSION 1 71
/* Version 1.71 */
/begin PROJECT ProjectName "Project Comment Goes Here"
/begin HEADER "Header Comments go here" /end HEADER
/begin MODULE ModuleName "Module Comment Goes Here"
/begin MOD_PAR "MOD PAR Comment Goes Here" /end MOD_PAR
/begin MOD_COMMON "Mod Common Comment Here" BYTE_ORDER MSB_LAST ALIGNMENT_BYTE 1 ALIGNMENT_WORD 2 ALIGNMENT_LONG 4 ALIGNMENT_FLOAT32_IEEE 4 ALIGNMENT_FLOAT64_IEEE 8 ALIGNMENT_INT64 8 /end MOD_COMMON
/begin CHARACTERISTIC AuxPwrAcvDebFall_C "Falling edge debounce time for input processing" VALUE 0x0000 /* @ECU_Address@AuxPwrAcvDebFall_C@ */ Record_FLOAT32_IEEE 0 P2319ASW01_CM_single_s 0.000000 60.000000 /end CHARACTERISTIC
/begin CHARACTERISTIC AuxPwrAcvDebRisng_C "Rising edge debounce time for input processing" VALUE 0x0000 /* @ECU_Address@AuxPwrAcvDebRisng_C@ */ Record_FLOAT32_IEEE 0 P2319ASW01_CM_single_s 0.000000 60.000000 /end CHARACTERISTIC
/begin CHARACTERISTIC AuxPwrAcvDialEna_C "Signal override enable" VALUE 0x0000 /* @ECU_Address@AuxPwrAcvDialEna_C@ */ Record_BOOLEAN 0 P2319ASW01_CM_boolean_1 0.000000 1.000000 /end CHARACTERISTIC
/begin CHARACTERISTIC AuxPwrAcvDialVal_C "Signal override value" VALUE 0x0000 /* @ECU_Address@AuxPwrAcvDialVal_C@ */ Record_BOOLEAN 0 P2319ASW01_CM_boolean_1 0.000000 1.000000 /end CHARACTERISTIC
/begin CHARACTERISTIC AuxPwrStsIvt_C "Invert the auxilary power status input" VALUE 0x0000 /* @ECU_Address@AuxPwrStsIvt_C@ */ Record_BOOLEAN 0 P2319ASW01_CM_boolean_1 0.000000 1.000000 /end CHARACTERISTIC
/begin CHARACTERISTIC BdT1DialEna_C "Signal override enable" VALUE 0x0000 /* @ECU_Address@BdT1DialEna_C@ */ Record_BOOLEAN 0 P2319ASW01_CM_boolean_1 0.000000 1.000000 /end CHARACTERISTIC
/begin CHARACTERISTIC BdT1DialVal_C "Signal override value" VALUE 0x0000 /* @ECU_Address@BdT1DialVal_C@ */ Record_FLOAT32_IEEE 0 P2319ASW01_CM_single_degC -40.000000 250.000000 /end CHARACTERISTIC
/begin CHARACTERISTIC BdT1FilTiCon_C "Low pass filter time constant for signal input processing" VALUE 0x0000 /* @ECU_Address@BdT1FilTiCon_C@ */ Record_FLOAT32_IEEE 0 P2319ASW01_CM_single_s 0.000000 60.000000 /end CHARACTERISTIC
/begin CHARACTERISTIC BdT1Gain_C "Gain to convert raw input to engineering units" VALUE 0x0000 /* @ECU_Address@BdT1Gain_C@ */ Record_FLOAT32_IEEE 0 P2319ASW01_CM_single_degC_per_1 -1000.000000 1000.000000 /end CHARACTERISTIC
/begin CHARACTERISTIC BdT1Ofs_C "Offset to convert raw input to engineering units" VALUE 0x0000 /* @ECU_Address@BdT1Ofs_C@ */ Record_FLOAT32_IEEE 0 P2319ASW01_CM_single_degC -1000.000000 1000.000000 /end CHARACTERISTIC
/begin CHARACTERISTIC BdT2DialEna_C "Signal override enable" VALUE 0x0000 /* @ECU_Address@BdT2DialEna_C@ */ Record_BOOLEAN 0 P2319ASW01_CM_boolean_1 0.000000 1.000000 /end CHARACTERISTIC
/begin CHARACTERISTIC BdT2DialVal_C "Signal override value" VALUE 0x0000 /* @ECU_Address@BdT2DialVal_C@ */ Record_FLOAT32_IEEE 0 P2319ASW01_CM_single_degC -40.000000 250.000000 /end CHARACTERISTIC
/begin CHARACTERISTIC BdT2FilTiCon_C "Low pass filter time constant for signal input processing" VALUE 0x0000 /* @ECU_Address@BdT2FilTiCon_C@ */ Record_FLOAT32_IEEE 0 P2319ASW01_CM_single_s 0.000000 60.000000 /end CHARACTERISTIC
/begin CHARACTERISTIC BdT2Gain_C "Gain to convert raw input to engineering units" VALUE 0x0000 /* @ECU_Address@BdT2Gain_C@ */ Record_FLOAT32_IEEE 0 P2319ASW01_CM_single_degC_per_1 -1000.000000 1000.000000 /end CHARACTERISTIC
/begin CHARACTERISTIC BdT2Ofs_C "Offset to convert raw input to engineering units" VALUE 0x0000 /* @ECU_Address@BdT2Ofs_C@ */ Record_FLOAT32_IEEE 0 P2319ASW01_CM_single_degC -40.000000 250.000000 /end CHARACTERISTIC
/begin CHARACTERISTIC CanPwrPwmEna_C "Enable CanPwr modulation output: 0 = disable, 1 = enable." VALUE 0x0000 /* @ECU_Address@CanPwrPwmEna_C@ */ Record_BOOLEAN 0 P2319ASW01_CM_boolean_1 0.000000 1.000000 /end CHARACTERISTIC
/begin CHARACTERISTIC DrvModDialEna_C "Signal override enable" VALUE 0x0000 /* @ECU_Address@DrvModDialEna_C@ */ Record_BOOLEAN 0 P2319ASW01_CM_boolean_1 0.000000 1.000000 /end CHARACTERISTIC
/begin CHARACTERISTIC DrvModDialVal_C "Signal override value" VALUE 0x0000 /* @ECU_Address@DrvModDialVal_C@ */ Record_UBYTE 0 P2319ASW01_CM_DRIVEMODE_1 0 3 /end CHARACTERISTIC
/begin CHARACTERISTIC DrvModReqDft_C "The default value used for this signal when the message has timedout" VALUE 0x0000 /* @ECU_Address@DrvModReqDft_C@ */ Record_UBYTE 0 P2319ASW01_CM_DRIVEMODE_1 0 3 /end CHARACTERISTIC
/begin CHARACTERISTIC DrvModReqDialEna_C "Signal override enable" VALUE 0x0000 /* @ECU_Address@DrvModReqDialEna_C@ */ Record_BOOLEAN 0 P2319ASW01_CM_boolean_1 0.000000 1.000000 /end CHARACTERISTIC
/begin CHARACTERISTIC DrvModReqDialVal_C "Signal override value" VALUE 0x0000 /* @ECU_Address@DrvModReqDialVal_C@ */ Record_UBYTE 0 P2319ASW01_CM_DRIVEMODE_1 0 3 /end CHARACTERISTIC
/begin CHARACTERISTIC EncoderCtPerRev_C "The number of encoder counts per mechanical revolution" VALUE 0x0000 /* @ECU_Address@EncoderCtPerRev_C@ */ Record_UWORD 0 P2319ASW01_CM_uint16_1 0.000000 65000.000000 /end CHARACTERISTIC
/begin CHARACTERISTIC EncoderOfs_C "Offset used to align the encoder z signal with the true zero angle" VALUE 0x0000 /* @ECU_Address@EncoderOfs_C@ */ Record_FLOAT32_IEEE 0 P2319ASW01_CM_single_rad -6.000000 6.000000 /end CHARACTERISTIC
/begin CHARACTERISTIC FluxLinkage_C "The permanent magnet flux linkage of the motor" VALUE 0x0000 /* @ECU_Address@FluxLinkage_C@ */ Record_FLOAT32_IEEE 0 P2319ASW01_CM_single_V_into_s 0.000000 10.000000 /end CHARACTERISTIC
/begin CHARACTERISTIC GreenLedDialEna_C "Signal override enable" VALUE 0x0000 /* @ECU_Address@GreenLedDialEna_C@ */ Record_BOOLEAN 0 P2319ASW01_CM_boolean_1 0.000000 1.000000 /end CHARACTERISTIC
/begin CHARACTERISTIC GreenLedDialVal_C "Signal override value" VALUE 0x0000 /* @ECU_Address@GreenLedDialVal_C@ */ Record_BOOLEAN 0 P2319ASW01_CM_boolean_1 0.000000 1.000000 /end CHARACTERISTIC
/begin CHARACTERISTIC GreenLedIvt_C "Invert the LED command" VALUE 0x0000 /* @ECU_Address@GreenLedIvt_C@ */ Record_BOOLEAN 0 P2319ASW01_CM_boolean_1 0.000000 1.000000 /end CHARACTERISTIC
/begin CHARACTERISTIC HvBusCurDialEna_C "Signal override enable" VALUE 0x0000 /* @ECU_Address@HvBusCurDialEna_C@ */ Record_BOOLEAN 0 P2319ASW01_CM_boolean_1 0.000000 1.000000 /end CHARACTERISTIC
/begin CHARACTERISTIC HvBusCurDialVal_C "Signal override value" VALUE 0x0000 /* @ECU_Address@HvBusCurDialVal_C@ */ Record_FLOAT32_IEEE 0 P2319ASW01_CM_single_A -1000.000000 1000.000000 /end CHARACTERISTIC
/begin CHARACTERISTIC HvBusCurFilTiCon_C "Low pass filter time constant for signal input processing" VALUE 0x0000 /* @ECU_Address@HvBusCurFilTiCon_C@ */ Record_FLOAT32_IEEE 0 P2319ASW01_CM_single_s 0.000000 10.000000 /end CHARACTERISTIC
/begin CHARACTERISTIC HvBusCurGain_C "Gain to convert raw input to engineering units" VALUE 0x0000 /* @ECU_Address@HvBusCurGain_C@ */ Record_FLOAT32_IEEE 0 P2319ASW01_CM_single_A_per_1 -1000.000000 1000.000000 /end CHARACTERISTIC
/begin CHARACTERISTIC HvBusCurOfs_C "Offset to convert raw input to engineering units" VALUE 0x0000 /* @ECU_Address@HvBusCurOfs_C@ */ Record_FLOAT32_IEEE 0 P2319ASW01_CM_single_A -1000.000000 1000.000000 /end CHARACTERISTIC
/begin CHARACTERISTIC HvBusUDialEna_C "Signal override enable" VALUE 0x0000 /* @ECU_Address@HvBusUDialEna_C@ */ Record_BOOLEAN 0 P2319ASW01_CM_boolean_1 0.000000 1.000000 /end CHARACTERISTIC
/begin CHARACTERISTIC HvBusUDialVal_C "Signal override value" VALUE 0x0000 /* @ECU_Address@HvBusUDialVal_C@ */ Record_FLOAT32_IEEE 0 P2319ASW01_CM_single_V 0.000000 1000.000000 /end CHARACTERISTIC
/begin CHARACTERISTIC HvBusUFilTiCon_C "Low pass filter time constant for signal input processing" VALUE 0x0000 /* @ECU_Address@HvBusUFilTiCon_C@ */ Record_FLOAT32_IEEE 0 P2319ASW01_CM_single_s 0.000000 10.000000 /end CHARACTERISTIC
/begin CHARACTERISTIC HvBusUGain_C "Gain to convert raw input to engineering units" VALUE 0x0000 /* @ECU_Address@HvBusUGain_C@ */ Record_FLOAT32_IEEE 0 P2319ASW01_CM_single_V_per_1 -1000.000000 1000.000000 /end CHARACTERISTIC
/begin CHARACTERISTIC HvBusUOfs_C "Offset to convert raw input to engineering units" VALUE 0x0000 /* @ECU_Address@HvBusUOfs_C@ */ Record_FLOAT32_IEEE 0 P2319ASW01_CM_single_V -1000.000000 1000.000000 /end CHARACTERISTIC
/begin CHARACTERISTIC InPwrPwmEna_C "Enable InPwr modulation output: 0 = disable, 1 = enable." VALUE 0x0000 /* @ECU_Address@InPwrPwmEna_C@ */ Record_BOOLEAN 0 P2319ASW01_CM_boolean_1 0.000000 1.000000 /end CHARACTERISTIC
/begin CHARACTERISTIC LedOffTi_C "The time the LED is off between pulse groups" VALUE 0x0000 /* @ECU_Address@LedOffTi_C@ */ Record_FLOAT32_IEEE 0 P2319ASW01_CM_single_s 0.000000 60.000000 /end CHARACTERISTIC
/begin CHARACTERISTIC LedPlsCtDft_C "The number of on pulses for the LED while in this mode" VALUE 0x0000 /* @ECU_Address@LedPlsCtDft_C@ */ Record_UBYTE 0 P2319ASW01_CM_uint8_1 0.000000 255.000000 /end CHARACTERISTIC
/begin CHARACTERISTIC LedPlsCtOpenLoop_C "The number of on pulses for the LED while in this mode" VALUE 0x0000 /* @ECU_Address@LedPlsCtOpenLoop_C@ */ Record_UBYTE 0 P2319ASW01_CM_uint8_1 0.000000 255.000000 /end CHARACTERISTIC
/begin CHARACTERISTIC LedPlsCtSpdCtl_C "The number of on pulses for the LED while in this mode" VALUE 0x0000 /* @ECU_Address@LedPlsCtSpdCtl_C@ */ Record_UBYTE 0 P2319ASW01_CM_uint8_1 0.000000 255.000000 /end CHARACTERISTIC
/begin CHARACTERISTIC LedPlsCtTqCtl_C "The number of on pulses for the LED while in this mode" VALUE 0x0000 /* @ECU_Address@LedPlsCtTqCtl_C@ */ Record_UBYTE 0 P2319ASW01_CM_uint8_1 0.000000 255.000000 /end CHARACTERISTIC
/begin CHARACTERISTIC MaiPwrAcvDebFall_C "Falling edge debounce time for input processing" VALUE 0x0000 /* @ECU_Address@MaiPwrAcvDebFall_C@ */ Record_FLOAT32_IEEE 0 P2319ASW01_CM_single_s 0.000000 60.000000 /end CHARACTERISTIC
/begin CHARACTERISTIC MaiPwrAcvDebRisng_C "Rising edge debounce time for input processing" VALUE 0x0000 /* @ECU_Address@MaiPwrAcvDebRisng_C@ */ Record_FLOAT32_IEEE 0 P2319ASW01_CM_single_s 0.000000 60.000000 /end CHARACTERISTIC
/begin CHARACTERISTIC MaiPwrAcvDialEna_C "Signal override enable" VALUE 0x0000 /* @ECU_Address@MaiPwrAcvDialEna_C@ */ Record_BOOLEAN 0 P2319ASW01_CM_boolean_1 0.000000 1.000000 /end CHARACTERISTIC
/begin CHARACTERISTIC MaiPwrAcvDialVal_C "Signal override value" VALUE 0x0000 /* @ECU_Address@MaiPwrAcvDialVal_C@ */ Record_BOOLEAN 0 P2319ASW01_CM_boolean_1 0.000000 1.000000 /end CHARACTERISTIC
/begin CHARACTERISTIC MaiPwrStsIvt_C "Invert the main power status input" VALUE 0x0000 /* @ECU_Address@MaiPwrStsIvt_C@ */ Record_BOOLEAN 0 P2319ASW01_CM_boolean_1 0.000000 1.000000 /end CHARACTERISTIC
/begin CHARACTERISTIC McuData1DaDialEna_C "Signal override enable" VALUE 0x0000 /* @ECU_Address@McuData1DaDialEna_C@ */ Record_BOOLEAN 0 P2319ASW01_CM_boolean_1 0.000000 1.000000 /end CHARACTERISTIC
/begin CHARACTERISTIC McuData1DaDialVal_CA "Signal override value" VAL_BLK 0x0000 /* @ECU_Address@McuData1DaDialVal_CA@ */ Record_UBYTE 0 P2319ASW01_CM_uint8_1 0.000000 255.000000 MATRIX_DIM 8 1 /end CHARACTERISTIC
/begin CHARACTERISTIC McuData2DaDialEna_C "Signal override enable" VALUE 0x0000 /* @ECU_Address@McuData2DaDialEna_C@ */ Record_BOOLEAN 0 P2319ASW01_CM_boolean_1 0.000000 1.000000 /end CHARACTERISTIC
/begin CHARACTERISTIC McuData2DaDialVal_CA "Signal override value" VAL_BLK 0x0000 /* @ECU_Address@McuData2DaDialVal_CA@ */ Record_UBYTE 0 P2319ASW01_CM_uint8_1 0.000000 255.000000 MATRIX_DIM 8 1 /end CHARACTERISTIC
/begin CHARACTERISTIC McuReqTout_C "Timeout time for the MCUReq message" VALUE 0x0000 /* @ECU_Address@McuReqTout_C@ */ Record_FLOAT32_IEEE 0 P2319ASW01_CM_single_s 0.000000 10.000000 /end CHARACTERISTIC
/begin CHARACTERISTIC McuTDialEna_C "Signal override enable" VALUE 0x0000 /* @ECU_Address@McuTDialEna_C@ */ Record_BOOLEAN 0 P2319ASW01_CM_boolean_1 0.000000 1.000000 /end CHARACTERISTIC
/begin CHARACTERISTIC McuTDialVal_C "Signal override value" VALUE 0x0000 /* @ECU_Address@McuTDialVal_C@ */ Record_FLOAT32_IEEE 0 P2319ASW01_CM_single_degC -40.000000 250.000000 /end CHARACTERISTIC
/begin CHARACTERISTIC McuTFilTiCon_C "Low pass filter time constant for signal input processing" VALUE 0x0000 /* @ECU_Address@McuTFilTiCon_C@ */ Record_FLOAT32_IEEE 0 P2319ASW01_CM_single_s 0.000000 60.000000 /end CHARACTERISTIC
/begin CHARACTERISTIC McuTGain_C "Gain to convert raw input to engineering units" VALUE 0x0000 /* @ECU_Address@McuTGain_C@ */ Record_FLOAT32_IEEE 0 P2319ASW01_CM_single_degC_per_1 -1000.000000 1000.000000 /end CHARACTERISTIC
/begin CHARACTERISTIC McuTOfs_C "Offset to convert raw input to engineering units" VALUE 0x0000 /* @ECU_Address@McuTOfs_C@ */ Record_FLOAT32_IEEE 0 P2319ASW01_CM_single_degC -1000.000000 1000.000000 /end CHARACTERISTIC
/begin CHARACTERISTIC McuUBatFilTiCon_C "Low pass filter time constant for signal input processing" VALUE 0x0000 /* @ECU_Address@McuUBatFilTiCon_C@ */ Record_FLOAT32_IEEE 0 P2319ASW01_CM_single_s 0.000000 60.000000 /end CHARACTERISTIC
/begin CHARACTERISTIC McuUBatGain_C "Gain to convert raw input to engineering units" VALUE 0x0000 /* @ECU_Address@McuUBatGain_C@ */ Record_FLOAT32_IEEE 0 P2319ASW01_CM_single_V_per_1 -1000.000000 1000.000000 /end CHARACTERISTIC
/begin CHARACTERISTIC McuUBatOfs_C "Offset to convert raw input to engineering units" VALUE 0x0000 /* @ECU_Address@McuUBatOfs_C@ */ Record_FLOAT32_IEEE 0 P2319ASW01_CM_single_V -1000.000000 1000.000000 /end CHARACTERISTIC
/begin CHARACTERISTIC McuURefFilTiCon_C "Low pass filter time constant for signal input processing" VALUE 0x0000 /* @ECU_Address@McuURefFilTiCon_C@ */ Record_FLOAT32_IEEE 0 P2319ASW01_CM_single_s 0.000000 60.000000 /end CHARACTERISTIC
/begin CHARACTERISTIC McuURefGain_C "Gain to convert raw input to engineering units" VALUE 0x0000 /* @ECU_Address@McuURefGain_C@ */ Record_FLOAT32_IEEE 0 P2319ASW01_CM_single_V_per_1 -1000.000000 1000.000000 /end CHARACTERISTIC
/begin CHARACTERISTIC McuURefOfs_C "Offset to convert raw input to engineering units" VALUE 0x0000 /* @ECU_Address@McuURefOfs_C@ */ Record_FLOAT32_IEEE 0 P2319ASW01_CM_single_V -1000.000000 1000.000000 /end CHARACTERISTIC
/begin CHARACTERISTIC MotPolePairs_C "The number of pole pairs in the motor" VALUE 0x0000 /* @ECU_Address@MotPolePairs_C@ */ Record_UBYTE 0 P2319ASW01_CM_uint8_1 1.000000 100.000000 /end CHARACTERISTIC
/begin CHARACTERISTIC MotPosnEstimrGainI_C "Integral gain for MotPosn estimator." VALUE 0x0000 /* @ECU_Address@MotPosnEstimrGainI_C@ */ Record_FLOAT32_IEEE 0 P2319ASW01_CM_single_1_per_s_2 0.000000 1000000.000000 /end CHARACTERISTIC
/begin CHARACTERISTIC MotPosnEstimrGainP_C "Proportional gain for MotPosn estimator." VALUE 0x0000 /* @ECU_Address@MotPosnEstimrGainP_C@ */ Record_FLOAT32_IEEE 0 P2319ASW01_CM_single_1_per_s 0.000000 10000.000000 /end CHARACTERISTIC
/begin CHARACTERISTIC MotPosnEstimrIntglEna_C "MotPosn estimator integral enable: 0 = disable, 1 = enable." VALUE 0x0000 /* @ECU_Address@MotPosnEstimrIntglEna_C@ */ Record_BOOLEAN 0 P2319ASW01_CM_boolean_1 0.000000 1.000000 /end CHARACTERISTIC
/begin CHARACTERISTIC MotPosnMagDialEna_C "Signal override enable" VALUE 0x0000 /* @ECU_Address@MotPosnMagDialEna_C@ */ Record_BOOLEAN 0 P2319ASW01_CM_boolean_1 0.000000 1.000000 /end CHARACTERISTIC
/begin CHARACTERISTIC MotPosnMagDialVal_C "Signal override value" VALUE 0x0000 /* @ECU_Address@MotPosnMagDialVal_C@ */ Record_FLOAT32_IEEE 0 P2319ASW01_CM_single_rad 0.000000 6.283100 /end CHARACTERISTIC
/begin CHARACTERISTIC MotPosnOfs_C "Motor position offset." VALUE 0x0000 /* @ECU_Address@MotPosnOfs_C@ */ Record_FLOAT32_IEEE 0 P2319ASW01_CM_single_rad -6.283200 6.283200 /end CHARACTERISTIC
/begin CHARACTERISTIC MotPosnSenMeth_C "Motor position sensing method: 0 = encoder, 1 = resolver." VALUE 0x0000 /* @ECU_Address@MotPosnSenMeth_C@ */ Record_BOOLEAN 0 P2319ASW01_CM_boolean_1 0.000000 1.000000 /end CHARACTERISTIC
/begin CHARACTERISTIC MotPosnTrigDialEna_C "Signal override enable" VALUE 0x0000 /* @ECU_Address@MotPosnTrigDialEna_C@ */ Record_BOOLEAN 0 P2319ASW01_CM_boolean_1 0.000000 1.000000 /end CHARACTERISTIC
/begin CHARACTERISTIC MotPosnTrigDialVal_CA "Signal override value" VAL_BLK 0x0000 /* @ECU_Address@MotPosnTrigDialVal_CA@ */ Record_FLOAT32_IEEE 0 P2319ASW01_CM_single_1 -100.000000 100.000000 MATRIX_DIM 6 1 /end CHARACTERISTIC
/begin CHARACTERISTIC MotSpdDialEna_C "Signal override enable" VALUE 0x0000 /* @ECU_Address@MotSpdDialEna_C@ */ Record_BOOLEAN 0 P2319ASW01_CM_boolean_1 0.000000 1.000000 /end CHARACTERISTIC
/begin CHARACTERISTIC MotSpdDialVal_C "Signal override value" VALUE 0x0000 /* @ECU_Address@MotSpdDialVal_C@ */ Record_SWORD 0 P2319ASW01_CM_int16_rpm -32000.000000 32000.000000 /end CHARACTERISTIC
/begin CHARACTERISTIC MotSpdFilTiCon_C "Low pass filter time constant for this signal" VALUE 0x0000 /* @ECU_Address@MotSpdFilTiCon_C@ */ Record_FLOAT32_IEEE 0 P2319ASW01_CM_single_s 0.000000 10.000000 /end CHARACTERISTIC
/begin CHARACTERISTIC MotSpdMagDialEna_C "Signal override enable" VALUE 0x0000 /* @ECU_Address@MotSpdMagDialEna_C@ */ Record_BOOLEAN 0 P2319ASW01_CM_boolean_1 0.000000 1.000000 /end CHARACTERISTIC
/begin CHARACTERISTIC MotSpdMagDialVal_C "Signal override value" VALUE 0x0000 /* @ECU_Address@MotSpdMagDialVal_C@ */ Record_FLOAT32_IEEE 0 P2319ASW01_CM_single_rad_per_s -100000.000000 100000.000000 /end CHARACTERISTIC
/begin CHARACTERISTIC MotSpdRateLim_C "The maximum rate at which the motor speed command is allowed to change" VALUE 0x0000 /* @ECU_Address@MotSpdRateLim_C@ */ Record_FLOAT32_IEEE 0 P2319ASW01_CM_single_rpm_per_sec 0.000000 1000000.000000 /end CHARACTERISTIC
/begin CHARACTERISTIC MotSpdReqCanDft_C "The default value used for this signal when the message has timedout" VALUE 0x0000 /* @ECU_Address@MotSpdReqCanDft_C@ */ Record_SWORD 0 P2319ASW01_CM_int16_rpm -32000.000000 32000.000000 /end CHARACTERISTIC
/begin CHARACTERISTIC MotSpdReqCanDialEna_C "Signal override enable" VALUE 0x0000 /* @ECU_Address@MotSpdReqCanDialEna_C@ */ Record_BOOLEAN 0 P2319ASW01_CM_boolean_1 0.000000 1.000000 /end CHARACTERISTIC
/begin CHARACTERISTIC MotSpdReqCanDialVal_C "Signal override value" VALUE 0x0000 /* @ECU_Address@MotSpdReqCanDialVal_C@ */ Record_SWORD 0 P2319ASW01_CM_int16_rpm -32000.000000 32000.000000 /end CHARACTERISTIC
/begin CHARACTERISTIC MotSpdReqMax_C "The maximum magnitued of the speed command the control will attempt to control to" VALUE 0x0000 /* @ECU_Address@MotSpdReqMax_C@ */ Record_SWORD 0 P2319ASW01_CM_int16_rpm 0.000000 32000.000000 /end CHARACTERISTIC
/begin CHARACTERISTIC MotSpdReqThdModChg_C "The motor speed request below which the drive is allowed to change modes" VALUE 0x0000 /* @ECU_Address@MotSpdReqThdModChg_C@ */ Record_UWORD 0 P2319ASW01_CM_uint16_rpm 0.000000 50000.000000 /end CHARACTERISTIC
/begin CHARACTERISTIC MotSpdThdModChg_C "The motor speed below which the drive is allowed to change modes" VALUE 0x0000 /* @ECU_Address@MotSpdThdModChg_C@ */ Record_UWORD 0 P2319ASW01_CM_uint16_rpm 0.000000 50000.000000 /end CHARACTERISTIC
/begin CHARACTERISTIC MotTqCmdSpdCtlDialEna_C "Signal override enable" VALUE 0x0000 /* @ECU_Address@MotTqCmdSpdCtlDialEna_C@ */ Record_BOOLEAN 0 P2319ASW01_CM_boolean_1 0.000000 1.000000 /end CHARACTERISTIC
/begin CHARACTERISTIC MotTqCmdSpdCtlDialVal_C "Signal override value" VALUE 0x0000 /* @ECU_Address@MotTqCmdSpdCtlDialVal_C@ */ Record_FLOAT32_IEEE 0 P2319ASW01_CM_single_N_into_m -10000.000000 10000.000000 /end CHARACTERISTIC
/begin CHARACTERISTIC MotTqCon_C "The motor constant that maps between current and torque" VALUE 0x0000 /* @ECU_Address@MotTqCon_C@ */ Record_FLOAT32_IEEE 0 P2319ASW01_CM_single_N_into_m_per_A 0.000000 1000.000000 /end CHARACTERISTIC
/begin CHARACTERISTIC MotTqGainBdT1_Ax "The axis for the table that maps between the board temperature and the gain that limits the maximum motor torque" VAL_BLK 0x0000 /* @ECU_Address@MotTqGainBdT1_Ax@ */ Record_FLOAT32_IEEE 0 P2319ASW01_CM_single_degC -40.000000 250.000000 MATRIX_DIM 5 1 /end CHARACTERISTIC
/begin CHARACTERISTIC MotTqGainBdT1_T "The table values for the table that maps between the board temperature and the gain that limits the maximum motor torque" CURVE 0x0000 /* @ECU_Address@MotTqGainBdT1_T@ */ Record_FLOAT32_IEEE 0 P2319ASW01_CM_single_1 0.000000 1.000000
 /begin AXIS_DESCR COM_AXIS NO_INPUT_QUANTITY P2319ASW01_CM_single_degC 5 -40.000000 250.000000 AXIS_PTS_REF MotTqGainBdT1_Ax /end AXIS_DESCR
/end CHARACTERISTIC
/begin CHARACTERISTIC MotTqGainBdT2_Ax "The axis for the table that maps between the board temperature and the gain that limits the maximum motor torque" VAL_BLK 0x0000 /* @ECU_Address@MotTqGainBdT2_Ax@ */ Record_FLOAT32_IEEE 0 P2319ASW01_CM_single_degC -40.000000 250.000000 MATRIX_DIM 5 1 /end CHARACTERISTIC
/begin CHARACTERISTIC MotTqGainBdT2_T "The table values for the table that maps between the board temperature and the gain that limits the maximum motor torque" CURVE 0x0000 /* @ECU_Address@MotTqGainBdT2_T@ */ Record_FLOAT32_IEEE 0 P2319ASW01_CM_single_1 0.000000 1.000000
 /begin AXIS_DESCR COM_AXIS NO_INPUT_QUANTITY P2319ASW01_CM_single_degC 5 -40.000000 250.000000 AXIS_PTS_REF MotTqGainBdT2_Ax /end AXIS_DESCR
/end CHARACTERISTIC
/begin CHARACTERISTIC MotTqGainI_C "Integral gain for motor speed control" VALUE 0x0000 /* @ECU_Address@MotTqGainI_C@ */ Record_FLOAT32_IEEE 0 P2319ASW01_CM_single_N_into_m_per__rpm_into_sec_ -1000.000000 1000.000000 /end CHARACTERISTIC
/begin CHARACTERISTIC MotTqGainP_C "Proportional gain for motor speed control" VALUE 0x0000 /* @ECU_Address@MotTqGainP_C@ */ Record_FLOAT32_IEEE 0 P2319ASW01_CM_single_N_into_m_per_rpm -1000.000000 1000.000000 /end CHARACTERISTIC
/begin CHARACTERISTIC MotTqMaxDialEna_C "Signal override enable" VALUE 0x0000 /* @ECU_Address@MotTqMaxDialEna_C@ */ Record_BOOLEAN 0 P2319ASW01_CM_boolean_1 0.000000 1.000000 /end CHARACTERISTIC
/begin CHARACTERISTIC MotTqMaxDialVal_C "Signal override value" VALUE 0x0000 /* @ECU_Address@MotTqMaxDialVal_C@ */ Record_FLOAT32_IEEE 0 P2319ASW01_CM_single_N_into_m 0.000000 10000.000000 /end CHARACTERISTIC
/begin CHARACTERISTIC MotTqMaxMotSpd_Ax "The axis values for the table that maps between the motor speed and the maximum motor torque" VAL_BLK 0x0000 /* @ECU_Address@MotTqMaxMotSpd_Ax@ */ Record_FLOAT32_IEEE 0 P2319ASW01_CM_single_rpm 0.000000 32000.000000 MATRIX_DIM 5 1 /end CHARACTERISTIC
/begin CHARACTERISTIC MotTqMaxMotSpd_T "The table values for the table that maps between the motor speed and the maximum motor torque" CURVE 0x0000 /* @ECU_Address@MotTqMaxMotSpd_T@ */ Record_FLOAT32_IEEE 0 P2319ASW01_CM_single_N_into_m 0.000000 10000.000000
 /begin AXIS_DESCR COM_AXIS NO_INPUT_QUANTITY P2319ASW01_CM_single_rpm 5 0.000000 32000.000000 AXIS_PTS_REF MotTqMaxMotSpd_Ax /end AXIS_DESCR
/end CHARACTERISTIC
/begin CHARACTERISTIC MotTqReqCanDft_C "The default value used for this signal when the message has timedout" VALUE 0x0000 /* @ECU_Address@MotTqReqCanDft_C@ */ Record_FLOAT32_IEEE 0 P2319ASW01_CM_single_N_into_m -10000.000000 10000.000000 /end CHARACTERISTIC
/begin CHARACTERISTIC MotTqReqCanDialEna_C "Signal override enable" VALUE 0x0000 /* @ECU_Address@MotTqReqCanDialEna_C@ */ Record_BOOLEAN 0 P2319ASW01_CM_boolean_1 0.000000 1.000000 /end CHARACTERISTIC
/begin CHARACTERISTIC MotTqReqCanDialVal_C "Signal override value" VALUE 0x0000 /* @ECU_Address@MotTqReqCanDialVal_C@ */ Record_FLOAT32_IEEE 0 P2319ASW01_CM_single_N_into_m -10000.000000 10000.000000 /end CHARACTERISTIC
/begin CHARACTERISTIC MotTqReqThdModChg_C "The motor torque request below which the drive is allowed to change modes" VALUE 0x0000 /* @ECU_Address@MotTqReqThdModChg_C@ */ Record_FLOAT32_IEEE 0 P2319ASW01_CM_single_N_into_m 0.000000 10000.000000 /end CHARACTERISTIC
/begin CHARACTERISTIC MtrPwrPwmEna_C "Enable MtrPwr modulation output: 0 = disable, 1 = enable." VALUE 0x0000 /* @ECU_Address@MtrPwrPwmEna_C@ */ Record_BOOLEAN 0 P2319ASW01_CM_boolean_1 0.000000 1.000000 /end CHARACTERISTIC
/begin CHARACTERISTIC PhaAPwmDcDialEna_C "Signal override enable" VALUE 0x0000 /* @ECU_Address@PhaAPwmDcDialEna_C@ */ Record_BOOLEAN 0 P2319ASW01_CM_boolean_1 0.000000 1.000000 /end CHARACTERISTIC
/begin CHARACTERISTIC PhaAPwmDcDialVal_C "Signal override value" VALUE 0x0000 /* @ECU_Address@PhaAPwmDcDialVal_C@ */ Record_UWORD 0 P2319ASW01_CM_uint16_1 0.000000 65000.000000 /end CHARACTERISTIC
/begin CHARACTERISTIC PhaBPwmDcDialEna_C "Signal override enable" VALUE 0x0000 /* @ECU_Address@PhaBPwmDcDialEna_C@ */ Record_BOOLEAN 0 P2319ASW01_CM_boolean_1 0.000000 1.000000 /end CHARACTERISTIC
/begin CHARACTERISTIC PhaBPwmDcDialVal_C "Signal override value" VALUE 0x0000 /* @ECU_Address@PhaBPwmDcDialVal_C@ */ Record_UWORD 0 P2319ASW01_CM_uint16_1 0.000000 65000.000000 /end CHARACTERISTIC
/begin CHARACTERISTIC PhaCPwmDcDialEna_C "Signal override enable" VALUE 0x0000 /* @ECU_Address@PhaCPwmDcDialEna_C@ */ Record_BOOLEAN 0 P2319ASW01_CM_boolean_1 0.000000 1.000000 /end CHARACTERISTIC
/begin CHARACTERISTIC PhaCPwmDcDialVal_C "Signal override value" VALUE 0x0000 /* @ECU_Address@PhaCPwmDcDialVal_C@ */ Record_UWORD 0 P2319ASW01_CM_uint16_1 0.000000 65000.000000 /end CHARACTERISTIC
/begin CHARACTERISTIC PhaCurADialEna_C "Signal override enable" VALUE 0x0000 /* @ECU_Address@PhaCurADialEna_C@ */ Record_BOOLEAN 0 P2319ASW01_CM_boolean_1 0.000000 1.000000 /end CHARACTERISTIC
/begin CHARACTERISTIC PhaCurADialVal_C "Signal override value" VALUE 0x0000 /* @ECU_Address@PhaCurADialVal_C@ */ Record_FLOAT32_IEEE 0 P2319ASW01_CM_single_A -1000.000000 1000.000000 /end CHARACTERISTIC
/begin CHARACTERISTIC PhaCurAFilTiCon_C "Low pass filter time constant for signal input processing" VALUE 0x0000 /* @ECU_Address@PhaCurAFilTiCon_C@ */ Record_FLOAT32_IEEE 0 P2319ASW01_CM_single_s 0.000000 10.000000 /end CHARACTERISTIC
/begin CHARACTERISTIC PhaCurAGain_C "Gain to convert raw input to engineering units" VALUE 0x0000 /* @ECU_Address@PhaCurAGain_C@ */ Record_FLOAT32_IEEE 0 P2319ASW01_CM_single_A_per_1 -1000.000000 1000.000000 /end CHARACTERISTIC
/begin CHARACTERISTIC PhaCurAOfs_C "Offset to convert raw input to engineering units" VALUE 0x0000 /* @ECU_Address@PhaCurAOfs_C@ */ Record_FLOAT32_IEEE 0 P2319ASW01_CM_single_A -1000.000000 1000.000000 /end CHARACTERISTIC
/begin CHARACTERISTIC PhaCurBDialEna_C "Signal override enable" VALUE 0x0000 /* @ECU_Address@PhaCurBDialEna_C@ */ Record_BOOLEAN 0 P2319ASW01_CM_boolean_1 0.000000 1.000000 /end CHARACTERISTIC
/begin CHARACTERISTIC PhaCurBDialVal_C "Signal override value" VALUE 0x0000 /* @ECU_Address@PhaCurBDialVal_C@ */ Record_FLOAT32_IEEE 0 P2319ASW01_CM_single_A -1000.000000 1000.000000 /end CHARACTERISTIC
/begin CHARACTERISTIC PhaCurBFilTiCon_C "Low pass filter time constant for signal input processing" VALUE 0x0000 /* @ECU_Address@PhaCurBFilTiCon_C@ */ Record_FLOAT32_IEEE 0 P2319ASW01_CM_single_s 0.000000 10.000000 /end CHARACTERISTIC
/begin CHARACTERISTIC PhaCurBGain_C "Gain to convert raw input to engineering units" VALUE 0x0000 /* @ECU_Address@PhaCurBGain_C@ */ Record_FLOAT32_IEEE 0 P2319ASW01_CM_single_A_per_1 -1000.000000 1000.000000 /end CHARACTERISTIC
/begin CHARACTERISTIC PhaCurBOfs_C "Offset to convert raw input to engineering units" VALUE 0x0000 /* @ECU_Address@PhaCurBOfs_C@ */ Record_FLOAT32_IEEE 0 P2319ASW01_CM_single_A -1000.000000 1000.000000 /end CHARACTERISTIC
/begin CHARACTERISTIC PhaCurCDialEna_C "Signal override enable" VALUE 0x0000 /* @ECU_Address@PhaCurCDialEna_C@ */ Record_BOOLEAN 0 P2319ASW01_CM_boolean_1 0.000000 1.000000 /end CHARACTERISTIC
/begin CHARACTERISTIC PhaCurCDialVal_C "Signal override value" VALUE 0x0000 /* @ECU_Address@PhaCurCDialVal_C@ */ Record_FLOAT32_IEEE 0 P2319ASW01_CM_single_A -1000.000000 1000.000000 /end CHARACTERISTIC
/begin CHARACTERISTIC PhaCurCFilTiCon_C "Low pass filter time constant for signal input processing" VALUE 0x0000 /* @ECU_Address@PhaCurCFilTiCon_C@ */ Record_FLOAT32_IEEE 0 P2319ASW01_CM_single_s 0.000000 10.000000 /end CHARACTERISTIC
/begin CHARACTERISTIC PhaCurCGain_C "Gain to convert raw input to engineering units" VALUE 0x0000 /* @ECU_Address@PhaCurCGain_C@ */ Record_FLOAT32_IEEE 0 P2319ASW01_CM_single_A_per_1 -1000.000000 1000.000000 /end CHARACTERISTIC
/begin CHARACTERISTIC PhaCurCOfs_C "Offset to convert raw input to engineering units" VALUE 0x0000 /* @ECU_Address@PhaCurCOfs_C@ */ Record_FLOAT32_IEEE 0 P2319ASW01_CM_single_A -1000.000000 1000.000000 /end CHARACTERISTIC
/begin CHARACTERISTIC PhaCurDDialEna_C "Signal override enable" VALUE 0x0000 /* @ECU_Address@PhaCurDDialEna_C@ */ Record_BOOLEAN 0 P2319ASW01_CM_boolean_1 0.000000 1.000000 /end CHARACTERISTIC
/begin CHARACTERISTIC PhaCurDDialVal_C "Signal override value" VALUE 0x0000 /* @ECU_Address@PhaCurDDialVal_C@ */ Record_FLOAT32_IEEE 0 P2319ASW01_CM_single_A -1000.000000 1000.000000 /end CHARACTERISTIC
/begin CHARACTERISTIC PhaCurDTarVal_C "Signal override value" VALUE 0x0000 /* @ECU_Address@PhaCurDTarVal_C@ */ Record_FLOAT32_IEEE 0 P2319ASW01_CM_single_A -1000.000000 1000.000000 /end CHARACTERISTIC
/begin CHARACTERISTIC PhaCurQDialEna_C "Signal override enable" VALUE 0x0000 /* @ECU_Address@PhaCurQDialEna_C@ */ Record_BOOLEAN 0 P2319ASW01_CM_boolean_1 0.000000 1.000000 /end CHARACTERISTIC
/begin CHARACTERISTIC PhaCurQDialVal_C "Signal override value" VALUE 0x0000 /* @ECU_Address@PhaCurQDialVal_C@ */ Record_FLOAT32_IEEE 0 P2319ASW01_CM_single_A -1000.000000 1000.000000 /end CHARACTERISTIC
/begin CHARACTERISTIC PhaCurQTarDialEna_C "Signal override enable" VALUE 0x0000 /* @ECU_Address@PhaCurQTarDialEna_C@ */ Record_BOOLEAN 0 P2319ASW01_CM_boolean_1 0.000000 1.000000 /end CHARACTERISTIC
/begin CHARACTERISTIC PhaCurQTarDialVal_C "Signal override value" VALUE 0x0000 /* @ECU_Address@PhaCurQTarDialVal_C@ */ Record_FLOAT32_IEEE 0 P2319ASW01_CM_single_A -1000.000000 1000.000000 /end CHARACTERISTIC
/begin CHARACTERISTIC PhaPwmEnaDialEna_C "Signal override enable" VALUE 0x0000 /* @ECU_Address@PhaPwmEnaDialEna_C@ */ Record_BOOLEAN 0 P2319ASW01_CM_boolean_1 0.000000 1.000000 /end CHARACTERISTIC
/begin CHARACTERISTIC PhaPwmEnaDialVal_C "Signal override value" VALUE 0x0000 /* @ECU_Address@PhaPwmEnaDialVal_C@ */ Record_BOOLEAN 0 P2319ASW01_CM_boolean_1 0.000000 1.000000 /end CHARACTERISTIC
/begin CHARACTERISTIC PhaUACmdDialEna_C "Signal override enable" VALUE 0x0000 /* @ECU_Address@PhaUACmdDialEna_C@ */ Record_BOOLEAN 0 P2319ASW01_CM_boolean_1 0.000000 1.000000 /end CHARACTERISTIC
/begin CHARACTERISTIC PhaUACmdDialVal_C "Signal override value" VALUE 0x0000 /* @ECU_Address@PhaUACmdDialVal_C@ */ Record_FLOAT32_IEEE 0 P2319ASW01_CM_single_V -1000.000000 1000.000000 /end CHARACTERISTIC
/begin CHARACTERISTIC PhaUAFilTiCon_C "Low pass filter time constant for signal input processing" VALUE 0x0000 /* @ECU_Address@PhaUAFilTiCon_C@ */ Record_FLOAT32_IEEE 0 P2319ASW01_CM_single_s 0.000000 10.000000 /end CHARACTERISTIC
/begin CHARACTERISTIC PhaUAGain_C "Gain to convert raw input to engineering units" VALUE 0x0000 /* @ECU_Address@PhaUAGain_C@ */ Record_FLOAT32_IEEE 0 P2319ASW01_CM_single_V_per_1 -1000.000000 1000.000000 /end CHARACTERISTIC
/begin CHARACTERISTIC PhaUAOfs_C "Offset to convert raw input to engineering units" VALUE 0x0000 /* @ECU_Address@PhaUAOfs_C@ */ Record_FLOAT32_IEEE 0 P2319ASW01_CM_single_V -1000.000000 1000.000000 /end CHARACTERISTIC
/begin CHARACTERISTIC PhaUBCmdDialEna_C "Signal override enable" VALUE 0x0000 /* @ECU_Address@PhaUBCmdDialEna_C@ */ Record_BOOLEAN 0 P2319ASW01_CM_boolean_1 0.000000 1.000000 /end CHARACTERISTIC
/begin CHARACTERISTIC PhaUBCmdDialVal_C "Signal override value" VALUE 0x0000 /* @ECU_Address@PhaUBCmdDialVal_C@ */ Record_FLOAT32_IEEE 0 P2319ASW01_CM_single_V -1000.000000 1000.000000 /end CHARACTERISTIC
/begin CHARACTERISTIC PhaUBFilTiCon_C "Low pass filter time constant for signal input processing" VALUE 0x0000 /* @ECU_Address@PhaUBFilTiCon_C@ */ Record_FLOAT32_IEEE 0 P2319ASW01_CM_single_s 0.000000 10.000000 /end CHARACTERISTIC
/begin CHARACTERISTIC PhaUBGain_C "Gain to convert raw input to engineering units" VALUE 0x0000 /* @ECU_Address@PhaUBGain_C@ */ Record_FLOAT32_IEEE 0 P2319ASW01_CM_single_V_per_1 -1000.000000 1000.000000 /end CHARACTERISTIC
/begin CHARACTERISTIC PhaUBOfs_C "Offset to convert raw input to engineering units" VALUE 0x0000 /* @ECU_Address@PhaUBOfs_C@ */ Record_FLOAT32_IEEE 0 P2319ASW01_CM_single_V -1000.000000 1000.000000 /end CHARACTERISTIC
/begin CHARACTERISTIC PhaUCCmdDialEna_C "Signal override enable" VALUE 0x0000 /* @ECU_Address@PhaUCCmdDialEna_C@ */ Record_BOOLEAN 0 P2319ASW01_CM_boolean_1 0.000000 1.000000 /end CHARACTERISTIC
/begin CHARACTERISTIC PhaUCCmdDialVal_C "Signal override value" VALUE 0x0000 /* @ECU_Address@PhaUCCmdDialVal_C@ */ Record_FLOAT32_IEEE 0 P2319ASW01_CM_single_V -1000.000000 1000.000000 /end CHARACTERISTIC
/begin CHARACTERISTIC PhaUCFilTiCon_C "Low pass filter time constant for signal input processing" VALUE 0x0000 /* @ECU_Address@PhaUCFilTiCon_C@ */ Record_FLOAT32_IEEE 0 P2319ASW01_CM_single_s 0.000000 10.000000 /end CHARACTERISTIC
/begin CHARACTERISTIC PhaUCGain_C "Gain to convert raw input to engineering units" VALUE 0x0000 /* @ECU_Address@PhaUCGain_C@ */ Record_FLOAT32_IEEE 0 P2319ASW01_CM_single_V_per_1 -1000.000000 1000.000000 /end CHARACTERISTIC
/begin CHARACTERISTIC PhaUCOfs_C "Offset to convert raw input to engineering units" VALUE 0x0000 /* @ECU_Address@PhaUCOfs_C@ */ Record_FLOAT32_IEEE 0 P2319ASW01_CM_single_V -1000.000000 1000.000000 /end CHARACTERISTIC
/begin CHARACTERISTIC PhaUDAntiWindupGain_C "Gain used to attenuate the integrated error when the output voltage command is saturated to avoid integral windup " VALUE 0x0000 /* @ECU_Address@PhaUDAntiWindupGain_C@ */ Record_FLOAT32_IEEE 0 P2319ASW01_CM_single_1_per_V -3.4E+38 3.4E+38 /end CHARACTERISTIC
/begin CHARACTERISTIC PhaUDCmdDialEna_C "Signal override enable" VALUE 0x0000 /* @ECU_Address@PhaUDCmdDialEna_C@ */ Record_BOOLEAN 0 P2319ASW01_CM_boolean_1 0.000000 1.000000 /end CHARACTERISTIC
/begin CHARACTERISTIC PhaUDCmdDialVal_C "Signal override value" VALUE 0x0000 /* @ECU_Address@PhaUDCmdDialVal_C@ */ Record_FLOAT32_IEEE 0 P2319ASW01_CM_single_V -1000.000000 1000.000000 /end CHARACTERISTIC
/begin CHARACTERISTIC PhaUDCmdOpenLoop_C "The d-axis phase voltage command in open loop mode" VALUE 0x0000 /* @ECU_Address@PhaUDCmdOpenLoop_C@ */ Record_FLOAT32_IEEE 0 P2319ASW01_CM_single_V -10000.000000 10000.000000 /end CHARACTERISTIC
/begin CHARACTERISTIC PhaUDGainI_C "Integral control gain for d-axis current control" VALUE 0x0000 /* @ECU_Address@PhaUDGainI_C@ */ Record_FLOAT32_IEEE 0 P2319ASW01_CM_single_V_per__A_into_s_ -10000.000000 10000.000000 /end CHARACTERISTIC
/begin CHARACTERISTIC PhaUDGainP_C "Proportional control gain for d-axis current control" VALUE 0x0000 /* @ECU_Address@PhaUDGainP_C@ */ Record_FLOAT32_IEEE 0 P2319ASW01_CM_single_V_per_A -10000.000000 10000.000000 /end CHARACTERISTIC
/begin CHARACTERISTIC PhaUMaxVal_C "The smallest value the maximum phase voltage is allowed to take on for current control calculations" VALUE 0x0000 /* @ECU_Address@PhaUMaxVal_C@ */ Record_FLOAT32_IEEE 0 P2319ASW01_CM_single_V -3.4E+38 3.4E+38 /end CHARACTERISTIC
/begin CHARACTERISTIC PhaUQAntiWindupGain_C "Gain used to attenuate the integrated error when the output voltage command is saturated to avoid integral windup" VALUE 0x0000 /* @ECU_Address@PhaUQAntiWindupGain_C@ */ Record_FLOAT32_IEEE 0 P2319ASW01_CM_single_1_per_V -3.4E+38 3.4E+38 /end CHARACTERISTIC
/begin CHARACTERISTIC PhaUQCmdDialEna_C "Signal override enable" VALUE 0x0000 /* @ECU_Address@PhaUQCmdDialEna_C@ */ Record_BOOLEAN 0 P2319ASW01_CM_boolean_1 0.000000 1.000000 /end CHARACTERISTIC
/begin CHARACTERISTIC PhaUQCmdDialVal_C "Signal override value" VALUE 0x0000 /* @ECU_Address@PhaUQCmdDialVal_C@ */ Record_FLOAT32_IEEE 0 P2319ASW01_CM_single_V -1000.000000 1000.000000 /end CHARACTERISTIC
/begin CHARACTERISTIC PhaUQCmdOpenLoop_C "The q-axis phase voltage command in open loop mode" VALUE 0x0000 /* @ECU_Address@PhaUQCmdOpenLoop_C@ */ Record_FLOAT32_IEEE 0 P2319ASW01_CM_single_V -10000.000000 10000.000000 /end CHARACTERISTIC
/begin CHARACTERISTIC PhaUQGainI_C "Integral control gain for q-axis current control" VALUE 0x0000 /* @ECU_Address@PhaUQGainI_C@ */ Record_FLOAT32_IEEE 0 P2319ASW01_CM_single_V_per__A_into_s_ -10000.000000 10000.000000 /end CHARACTERISTIC
/begin CHARACTERISTIC PhaUQGainP_C "Proportional control gain for q-axis current control" VALUE 0x0000 /* @ECU_Address@PhaUQGainP_C@ */ Record_FLOAT32_IEEE 0 P2319ASW01_CM_single_V_per_A -10000.000000 10000.000000 /end CHARACTERISTIC
/begin CHARACTERISTIC PlsOffTi_C "The time the LED is off between two pulses" VALUE 0x0000 /* @ECU_Address@PlsOffTi_C@ */ Record_FLOAT32_IEEE 0 P2319ASW01_CM_single_s 0.000000 60.000000 /end CHARACTERISTIC
/begin CHARACTERISTIC PlsOnTi_C "The time the LED is on during a pulse" VALUE 0x0000 /* @ECU_Address@PlsOnTi_C@ */ Record_FLOAT32_IEEE 0 P2319ASW01_CM_single_s 0.000000 60.000000 /end CHARACTERISTIC
/begin CHARACTERISTIC PwrCmdDialEna_C "Signal override enable" VALUE 0x0000 /* @ECU_Address@PwrCmdDialEna_C@ */ Record_BOOLEAN 0 P2319ASW01_CM_boolean_1 0.000000 1.000000 /end CHARACTERISTIC
/begin CHARACTERISTIC PwrCmdDialVal_C "Signal override value" VALUE 0x0000 /* @ECU_Address@PwrCmdDialVal_C@ */ Record_BOOLEAN 0 P2319ASW01_CM_boolean_1 0.000000 1.000000 /end CHARACTERISTIC
/begin CHARACTERISTIC RedLedDialEna_C "Signal override enable" VALUE 0x0000 /* @ECU_Address@RedLedDialEna_C@ */ Record_BOOLEAN 0 P2319ASW01_CM_boolean_1 0.000000 1.000000 /end CHARACTERISTIC
/begin CHARACTERISTIC RedLedDialVal_C "Signal override value" VALUE 0x0000 /* @ECU_Address@RedLedDialVal_C@ */ Record_BOOLEAN 0 P2319ASW01_CM_boolean_1 0.000000 1.000000 /end CHARACTERISTIC
/begin CHARACTERISTIC RedLedIvt_C "Invert the LED command" VALUE 0x0000 /* @ECU_Address@RedLedIvt_C@ */ Record_BOOLEAN 0 P2319ASW01_CM_boolean_1 0.000000 1.000000 /end CHARACTERISTIC
/begin CHARACTERISTIC ReloadRegisterMax_C "The maximum value of the register used by the hardware PWM generator" VALUE 0x0000 /* @ECU_Address@ReloadRegisterMax_C@ */ Record_SWORD 0 P2319ASW01_CM_int16_1 0.000000 32500.000000 /end CHARACTERISTIC
/begin CHARACTERISTIC ResolverCosFilTiCon_C "Low pass filter time constant for signal input processing" VALUE 0x0000 /* @ECU_Address@ResolverCosFilTiCon_C@ */ Record_FLOAT32_IEEE 0 P2319ASW01_CM_single_s 0.000000 10.000000 /end CHARACTERISTIC
/begin CHARACTERISTIC ResolverCosGain_C "Gain to convert raw input to engineering units" VALUE 0x0000 /* @ECU_Address@ResolverCosGain_C@ */ Record_FLOAT32_IEEE 0 P2319ASW01_CM_single_1 -1000.000000 1000.000000 /end CHARACTERISTIC
/begin CHARACTERISTIC ResolverCosOfs_C "Offset to convert raw input to engineering units" VALUE 0x0000 /* @ECU_Address@ResolverCosOfs_C@ */ Record_FLOAT32_IEEE 0 P2319ASW01_CM_single_1 -1000.000000 1000.000000 /end CHARACTERISTIC
/begin CHARACTERISTIC ResolverExctEna_C "Command to enable resolver excitation waveform generation: 0 = disable, 1 = enable." VALUE 0x0000 /* @ECU_Address@ResolverExctEna_C@ */ Record_BOOLEAN 0 P2319ASW01_CM_boolean_1 0.000000 1.000000 /end CHARACTERISTIC
/begin CHARACTERISTIC ResolverSinCosDialEna_C "Signal override enable" VALUE 0x0000 /* @ECU_Address@ResolverSinCosDialEna_C@ */ Record_BOOLEAN 0 P2319ASW01_CM_boolean_1 0.000000 1.000000 /end CHARACTERISTIC
/begin CHARACTERISTIC ResolverSinCosDialVal_CA "Signal override value" VAL_BLK 0x0000 /* @ECU_Address@ResolverSinCosDialVal_CA@ */ Record_FLOAT32_IEEE 0 P2319ASW01_CM_single_1 -1.000000 1.000000 MATRIX_DIM 2 1 /end CHARACTERISTIC
/begin CHARACTERISTIC ResolverSinFilTiCon_C "Low pass filter time constant for signal input processing" VALUE 0x0000 /* @ECU_Address@ResolverSinFilTiCon_C@ */ Record_FLOAT32_IEEE 0 P2319ASW01_CM_single_s 0.000000 10.000000 /end CHARACTERISTIC
/begin CHARACTERISTIC ResolverSinGain_C "Gain to convert raw input to engineering units" VALUE 0x0000 /* @ECU_Address@ResolverSinGain_C@ */ Record_FLOAT32_IEEE 0 P2319ASW01_CM_single_1 -1000.000000 1000.000000 /end CHARACTERISTIC
/begin CHARACTERISTIC ResolverSinOfs_C "Offset to convert raw input to engineering units" VALUE 0x0000 /* @ECU_Address@ResolverSinOfs_C@ */ Record_FLOAT32_IEEE 0 P2319ASW01_CM_single_1 -1000.000000 1000.000000 /end CHARACTERISTIC
/begin CHARACTERISTIC StatorInductanceD_C "The motor stator d-axis inductance" VALUE 0x0000 /* @ECU_Address@StatorInductanceD_C@ */ Record_FLOAT32_IEEE 0 P2319ASW01_CM_single_H 0.000000 10.000000 /end CHARACTERISTIC
/begin CHARACTERISTIC StatorInductanceQ_C "The motor stator q-axis inductance" VALUE 0x0000 /* @ECU_Address@StatorInductanceQ_C@ */ Record_FLOAT32_IEEE 0 P2319ASW01_CM_single_H 0.000000 10.000000 /end CHARACTERISTIC
/begin CHARACTERISTIC SwPwrPwmEna_C "Enable SwPwr modulation output: 0 = disable, 1 = enable." VALUE 0x0000 /* @ECU_Address@SwPwrPwmEna_C@ */ Record_BOOLEAN 0 P2319ASW01_CM_boolean_1 0.000000 1.000000 /end CHARACTERISTIC
/begin CHARACTERISTIC WakeRetry_C "Flag used to force the drive to try and rewake the board by activiting the power command" VALUE 0x0000 /* @ECU_Address@WakeRetry_C@ */ Record_BOOLEAN 0 P2319ASW01_CM_boolean_1 0.000000 1.000000 /end CHARACTERISTIC
/begin CHARACTERISTIC WakeTout_C "The amount of time the control waits for the power activation signal before shutting off the power command and terminating the wake attempt" VALUE 0x0000 /* @ECU_Address@WakeTout_C@ */ Record_FLOAT32_IEEE 0 P2319ASW01_CM_single_s 0.000000 60.000000 /end CHARACTERISTIC
/begin CHARACTERISTIC YellowLedCmd_C "Yellow LED activation command." VALUE 0x0000 /* @ECU_Address@YellowLedCmd_C@ */ Record_BOOLEAN 0 P2319ASW01_CM_boolean_1 0.000000 1.000000 /end CHARACTERISTIC
/begin MEASUREMENT ASWIN_AuxPwrSts "" UBYTE P2319ASW01_CM_logical_1 0 0 0 1 ECU_ADDRESS 0x0000 /* @ECU_Address@ASWIN_AuxPwrSts@ */
 /begin IF_DATA XCP
  /begin DAQ_EVENT VARIABLE /begin DEFAULT_EVENT_LIST EVENT 0x0002 /end DEFAULT_EVENT_LIST /end DAQ_EVENT
 /end IF_DATA
/end MEASUREMENT
/begin MEASUREMENT ASWIN_BdT1 "" UWORD P2319ASW01_CM_uint16_1 0 0 0 65535 ECU_ADDRESS 0x0000 /* @ECU_Address@ASWIN_BdT1@ */
 /begin IF_DATA XCP
  /begin DAQ_EVENT VARIABLE /begin DEFAULT_EVENT_LIST EVENT 0x0002 /end DEFAULT_EVENT_LIST /end DAQ_EVENT
 /end IF_DATA
/end MEASUREMENT
/begin MEASUREMENT ASWIN_BdT2 "" UWORD P2319ASW01_CM_uint16_1 0 0 0 65535 ECU_ADDRESS 0x0000 /* @ECU_Address@ASWIN_BdT2@ */
 /begin IF_DATA XCP
  /begin DAQ_EVENT VARIABLE /begin DEFAULT_EVENT_LIST EVENT 0x0002 /end DEFAULT_EVENT_LIST /end DAQ_EVENT
 /end IF_DATA
/end MEASUREMENT
/begin MEASUREMENT ASWIN_EncoderCt "" SWORD P2319ASW01_CM_int16_1 0 0 -32768 32767 ECU_ADDRESS 0x0000 /* @ECU_Address@ASWIN_EncoderCt@ */
 /begin IF_DATA XCP
  /begin DAQ_EVENT VARIABLE /begin DEFAULT_EVENT_LIST EVENT 0x0000 /end DEFAULT_EVENT_LIST /end DAQ_EVENT
 /end IF_DATA
/end MEASUREMENT
/begin MEASUREMENT ASWIN_EncoderZ "" UBYTE P2319ASW01_CM_logical_1 0 0 0 1 ECU_ADDRESS 0x0000 /* @ECU_Address@ASWIN_EncoderZ@ */
 /begin IF_DATA XCP
  /begin DAQ_EVENT VARIABLE /begin DEFAULT_EVENT_LIST EVENT 0x0000 /end DEFAULT_EVENT_LIST /end DAQ_EVENT
 /end IF_DATA
/end MEASUREMENT
/begin MEASUREMENT ASWIN_HvBusCur "" UWORD P2319ASW01_CM_uint16_1 0 0 0 65535 ECU_ADDRESS 0x0000 /* @ECU_Address@ASWIN_HvBusCur@ */
 /begin IF_DATA XCP
  /begin DAQ_EVENT VARIABLE /begin DEFAULT_EVENT_LIST EVENT 0x0000 /end DEFAULT_EVENT_LIST /end DAQ_EVENT
 /end IF_DATA
/end MEASUREMENT
/begin MEASUREMENT ASWIN_HvBusU "" UWORD P2319ASW01_CM_uint16_1 0 0 0 65535 ECU_ADDRESS 0x0000 /* @ECU_Address@ASWIN_HvBusU@ */
 /begin IF_DATA XCP
  /begin DAQ_EVENT VARIABLE /begin DEFAULT_EVENT_LIST EVENT 0x0000 /end DEFAULT_EVENT_LIST /end DAQ_EVENT
 /end IF_DATA
/end MEASUREMENT
/begin MEASUREMENT ASWIN_MaiPwrSts "" UBYTE P2319ASW01_CM_logical_1 0 0 0 1 ECU_ADDRESS 0x0000 /* @ECU_Address@ASWIN_MaiPwrSts@ */
 /begin IF_DATA XCP
  /begin DAQ_EVENT VARIABLE /begin DEFAULT_EVENT_LIST EVENT 0x0002 /end DEFAULT_EVENT_LIST /end DAQ_EVENT
 /end IF_DATA
/end MEASUREMENT
/begin MEASUREMENT ASWIN_McuReqCt "" UBYTE P2319ASW01_CM_uint8_1 0 0 0 255 ECU_ADDRESS 0x0000 /* @ECU_Address@ASWIN_McuReqCt@ */
 /begin IF_DATA XCP
  /begin DAQ_EVENT VARIABLE /begin DEFAULT_EVENT_LIST EVENT 0x0001 /end DEFAULT_EVENT_LIST /end DAQ_EVENT
 /end IF_DATA
/end MEASUREMENT
/begin MEASUREMENT ASWIN_McuReqDa "" UBYTE P2319ASW01_CM_uint8_1 0 0 0 255 LAYOUT COLUMN_DIR MATRIX_DIM 8 ECU_ADDRESS 0x0000 /* @ECU_Address@ASWIN_McuReqDa@ */
 /begin IF_DATA XCP
  /begin DAQ_EVENT VARIABLE /begin DEFAULT_EVENT_LIST EVENT 0x0001 /end DEFAULT_EVENT_LIST /end DAQ_EVENT
 /end IF_DATA
/end MEASUREMENT
/begin MEASUREMENT ASWIN_McuT "" UWORD P2319ASW01_CM_uint16_1 0 0 0 65535 ECU_ADDRESS 0x0000 /* @ECU_Address@ASWIN_McuT@ */
 /begin IF_DATA XCP
  /begin DAQ_EVENT VARIABLE /begin DEFAULT_EVENT_LIST EVENT 0x0002 /end DEFAULT_EVENT_LIST /end DAQ_EVENT
 /end IF_DATA
/end MEASUREMENT
/begin MEASUREMENT ASWIN_McuUBat "" UWORD P2319ASW01_CM_uint16_1 0 0 0 65535 ECU_ADDRESS 0x0000 /* @ECU_Address@ASWIN_McuUBat@ */
 /begin IF_DATA XCP
  /begin DAQ_EVENT VARIABLE /begin DEFAULT_EVENT_LIST EVENT 0x0002 /end DEFAULT_EVENT_LIST /end DAQ_EVENT
 /end IF_DATA
/end MEASUREMENT
/begin MEASUREMENT ASWIN_McuURef "" UWORD P2319ASW01_CM_uint16_1 0 0 0 65535 ECU_ADDRESS 0x0000 /* @ECU_Address@ASWIN_McuURef@ */
 /begin IF_DATA XCP
  /begin DAQ_EVENT VARIABLE /begin DEFAULT_EVENT_LIST EVENT 0x0002 /end DEFAULT_EVENT_LIST /end DAQ_EVENT
 /end IF_DATA
/end MEASUREMENT
/begin MEASUREMENT ASWIN_PhaCurA "" UWORD P2319ASW01_CM_uint16_1 0 0 0 65535 ECU_ADDRESS 0x0000 /* @ECU_Address@ASWIN_PhaCurA@ */
 /begin IF_DATA XCP
  /begin DAQ_EVENT VARIABLE /begin DEFAULT_EVENT_LIST EVENT 0x0000 /end DEFAULT_EVENT_LIST /end DAQ_EVENT
 /end IF_DATA
/end MEASUREMENT
/begin MEASUREMENT ASWIN_PhaCurB "" UWORD P2319ASW01_CM_uint16_1 0 0 0 65535 ECU_ADDRESS 0x0000 /* @ECU_Address@ASWIN_PhaCurB@ */
 /begin IF_DATA XCP
  /begin DAQ_EVENT VARIABLE /begin DEFAULT_EVENT_LIST EVENT 0x0000 /end DEFAULT_EVENT_LIST /end DAQ_EVENT
 /end IF_DATA
/end MEASUREMENT
/begin MEASUREMENT ASWIN_PhaCurC "" UWORD P2319ASW01_CM_uint16_1 0 0 0 65535 ECU_ADDRESS 0x0000 /* @ECU_Address@ASWIN_PhaCurC@ */
 /begin IF_DATA XCP
  /begin DAQ_EVENT VARIABLE /begin DEFAULT_EVENT_LIST EVENT 0x0000 /end DEFAULT_EVENT_LIST /end DAQ_EVENT
 /end IF_DATA
/end MEASUREMENT
/begin MEASUREMENT ASWIN_PhaUA "" UWORD P2319ASW01_CM_uint16_1 0 0 0 65535 ECU_ADDRESS 0x0000 /* @ECU_Address@ASWIN_PhaUA@ */
 /begin IF_DATA XCP
  /begin DAQ_EVENT VARIABLE /begin DEFAULT_EVENT_LIST EVENT 0x0000 /end DEFAULT_EVENT_LIST /end DAQ_EVENT
 /end IF_DATA
/end MEASUREMENT
/begin MEASUREMENT ASWIN_PhaUB "" UWORD P2319ASW01_CM_uint16_1 0 0 0 65535 ECU_ADDRESS 0x0000 /* @ECU_Address@ASWIN_PhaUB@ */
 /begin IF_DATA XCP
  /begin DAQ_EVENT VARIABLE /begin DEFAULT_EVENT_LIST EVENT 0x0000 /end DEFAULT_EVENT_LIST /end DAQ_EVENT
 /end IF_DATA
/end MEASUREMENT
/begin MEASUREMENT ASWIN_PhaUC "" UWORD P2319ASW01_CM_uint16_1 0 0 0 65535 ECU_ADDRESS 0x0000 /* @ECU_Address@ASWIN_PhaUC@ */
 /begin IF_DATA XCP
  /begin DAQ_EVENT VARIABLE /begin DEFAULT_EVENT_LIST EVENT 0x0000 /end DEFAULT_EVENT_LIST /end DAQ_EVENT
 /end IF_DATA
/end MEASUREMENT
/begin MEASUREMENT ASWIN_ResolverCos "" UWORD P2319ASW01_CM_uint16_1 0 0 0 65535 ECU_ADDRESS 0x0000 /* @ECU_Address@ASWIN_ResolverCos@ */
 /begin IF_DATA XCP
  /begin DAQ_EVENT VARIABLE /begin DEFAULT_EVENT_LIST EVENT 0x0000 /end DEFAULT_EVENT_LIST /end DAQ_EVENT
 /end IF_DATA
/end MEASUREMENT
/begin MEASUREMENT ASWIN_ResolverSin "" UWORD P2319ASW01_CM_uint16_1 0 0 0 65535 ECU_ADDRESS 0x0000 /* @ECU_Address@ASWIN_ResolverSin@ */
 /begin IF_DATA XCP
  /begin DAQ_EVENT VARIABLE /begin DEFAULT_EVENT_LIST EVENT 0x0000 /end DEFAULT_EVENT_LIST /end DAQ_EVENT
 /end IF_DATA
/end MEASUREMENT
/begin MEASUREMENT ASWOUT_CanPwrPwmEna "The raw output value" UBYTE SLWOUP_CM_boolean_1 0 0 0 1 ECU_ADDRESS 0x0000 /* @ECU_Address@ASWOUT_CanPwrPwmEna@ */ /end MEASUREMENT
/begin MEASUREMENT ASWOUT_GreenLed "The raw output value" UBYTE SLWOUP_CM_boolean_1 0 0 0 1 ECU_ADDRESS 0x0000 /* @ECU_Address@ASWOUT_GreenLed@ */ /end MEASUREMENT
/begin MEASUREMENT ASWOUT_InPwrPwmEna "The raw output value" UBYTE SLWOUP_CM_boolean_1 0 0 0 1 ECU_ADDRESS 0x0000 /* @ECU_Address@ASWOUT_InPwrPwmEna@ */ /end MEASUREMENT
/begin MEASUREMENT ASWOUT_McuData1Da "The raw message data frame" UBYTE MEDOUP_CM_uint8_1 0 0 0 255 LAYOUT COLUMN_DIR MATRIX_DIM 8 ECU_ADDRESS 0x0000 /* @ECU_Address@ASWOUT_McuData1Da@ */ /end MEASUREMENT
/begin MEASUREMENT ASWOUT_McuData2Da "The raw message data frame" UBYTE SLWOUP_CM_uint8_1 0 0 0 255 LAYOUT COLUMN_DIR MATRIX_DIM 8 ECU_ADDRESS 0x0000 /* @ECU_Address@ASWOUT_McuData2Da@ */ /end MEASUREMENT
/begin MEASUREMENT ASWOUT_MtrPwrPwmEna "The raw output value" UBYTE SLWOUP_CM_boolean_1 0 0 0 1 ECU_ADDRESS 0x0000 /* @ECU_Address@ASWOUT_MtrPwrPwmEna@ */ /end MEASUREMENT
/begin MEASUREMENT ASWOUT_PhaAPwmDc "The raw modulation command used by the hardware PWM generator" UWORD GATOUP_CM_uint16_1 0 0 0 65535 ECU_ADDRESS 0x0000 /* @ECU_Address@ASWOUT_PhaAPwmDc@ */ /end MEASUREMENT
/begin MEASUREMENT ASWOUT_PhaBPwmDc "The raw modulation command used by the hardware PWM generator" UWORD GATOUP_CM_uint16_1 0 0 0 65535 ECU_ADDRESS 0x0000 /* @ECU_Address@ASWOUT_PhaBPwmDc@ */ /end MEASUREMENT
/begin MEASUREMENT ASWOUT_PhaCPwmDc "The raw modulation command used by the hardware PWM generator" UWORD GATOUP_CM_uint16_1 0 0 0 65535 ECU_ADDRESS 0x0000 /* @ECU_Address@ASWOUT_PhaCPwmDc@ */ /end MEASUREMENT
/begin MEASUREMENT ASWOUT_PhaPwmEna "The raw modulation enable command used by the hardware PWM generator: 0 = disable, 1 = enable." UBYTE SLWOUP_CM_boolean_1 0 0 0 1 ECU_ADDRESS 0x0000 /* @ECU_Address@ASWOUT_PhaPwmEna@ */ /end MEASUREMENT
/begin MEASUREMENT ASWOUT_RedLed "The raw output value" UBYTE SLWOUP_CM_boolean_1 0 0 0 1 ECU_ADDRESS 0x0000 /* @ECU_Address@ASWOUT_RedLed@ */ /end MEASUREMENT
/begin MEASUREMENT ASWOUT_ResolverExctEna "The raw output value" UBYTE SLWOUP_CM_boolean_1 0 0 0 1 ECU_ADDRESS 0x0000 /* @ECU_Address@ASWOUT_ResolverExctEna@ */ /end MEASUREMENT
/begin MEASUREMENT ASWOUT_SwPwrPwmEna "The raw output value" UBYTE SLWOUP_CM_boolean_1 0 0 0 1 ECU_ADDRESS 0x0000 /* @ECU_Address@ASWOUT_SwPwrPwmEna@ */ /end MEASUREMENT
/begin MEASUREMENT ASWOUT_YellowLed "The raw output value" UBYTE SLWOUP_CM_boolean_1 0 0 0 1 ECU_ADDRESS 0x0000 /* @ECU_Address@ASWOUT_YellowLed@ */ /end MEASUREMENT
/begin MEASUREMENT AuxPwrAcv "Auxilary power active flag" UBYTE SLWINP_CM_boolean_1 0 0 0 1 ECU_ADDRESS 0x0000 /* @ECU_Address@AuxPwrAcv@ */ /end MEASUREMENT
/begin MEASUREMENT BdT1 "Board temperature 1" FLOAT32_IEEE SLWINP_CM_single_degC 0 0 -3.4E+38 3.4E+38 ECU_ADDRESS 0x0000 /* @ECU_Address@BdT1@ */ /end MEASUREMENT
/begin MEASUREMENT BdT2 "Board temperature 2" FLOAT32_IEEE SLWINP_CM_single_degC 0 0 -3.4E+38 3.4E+38 ECU_ADDRESS 0x0000 /* @ECU_Address@BdT2@ */ /end MEASUREMENT
/begin MEASUREMENT DrvMod "The active drive mode" UBYTE MODCTL_CM_DRIVEMODE_1 0 0 0 3 ECU_ADDRESS 0x0000 /* @ECU_Address@DrvMod@ */ /end MEASUREMENT
/begin MEASUREMENT DrvModReq "The requested drive mode" UBYTE MEDINP_CM_DRIVEMODE_1 0 0 0 3 ECU_ADDRESS 0x0000 /* @ECU_Address@DrvModReq@ */ /end MEASUREMENT
/begin MEASUREMENT HvBusCur "The DC bus current into the inverter" FLOAT32_IEEE ADCINP_CM_single_A 0 0 -3.4E+38 3.4E+38 ECU_ADDRESS 0x0000 /* @ECU_Address@HvBusCur@ */ /end MEASUREMENT
/begin MEASUREMENT HvBusU "The DC bus voltage into the inverter" FLOAT32_IEEE ADCINP_CM_single_V 0 0 -3.4E+38 3.4E+38 ECU_ADDRESS 0x0000 /* @ECU_Address@HvBusU@ */ /end MEASUREMENT
/begin MEASUREMENT MaiPwrAcv "Main power active flag" UBYTE SLWINP_CM_boolean_1 0 0 0 1 ECU_ADDRESS 0x0000 /* @ECU_Address@MaiPwrAcv@ */ /end MEASUREMENT
/begin MEASUREMENT McuT "Microcontroller temperature" FLOAT32_IEEE SLWINP_CM_single_degC 0 0 -3.4E+38 3.4E+38 ECU_ADDRESS 0x0000 /* @ECU_Address@McuT@ */ /end MEASUREMENT
/begin MEASUREMENT McuUBat "" FLOAT32_IEEE SLWINP_CM_single_V 0 0 -3.4E+38 3.4E+38 ECU_ADDRESS 0x0000 /* @ECU_Address@McuUBat@ */ /end MEASUREMENT
/begin MEASUREMENT McuURef "" FLOAT32_IEEE SLWINP_CM_single_V 0 0 -3.4E+38 3.4E+38 ECU_ADDRESS 0x0000 /* @ECU_Address@McuURef@ */ /end MEASUREMENT
/begin MEASUREMENT MotPosnErr "Motor position error." FLOAT32_IEEE POSINP_CM_single_rad 0 0 -3.4E+38 3.4E+38 ECU_ADDRESS 0x0000 /* @ECU_Address@MotPosnErr@ */ /end MEASUREMENT
/begin MEASUREMENT MotPosnMag "The magnetic rotor position. Zero degrees represents the rotor magnetic field aligned with the stator\'s A phase." FLOAT32_IEEE POSINP_CM_single_rad 0 0 -3.4E+38 3.4E+38 ECU_ADDRESS 0x0000 /* @ECU_Address@MotPosnMag@ */ /end MEASUREMENT
/begin MEASUREMENT MotPosnMagMeasd "The measured magnetic motor position. Can be used in open loop control to verify position measurement." FLOAT32_IEEE POSINP_CM_single_rad 0 0 -3.4E+38 3.4E+38 ECU_ADDRESS 0x0000 /* @ECU_Address@MotPosnMagMeasd@ */ /end MEASUREMENT
/begin MEASUREMENT MotPosnTrig "The results of the trig calculations that are used in the reference frame transforms" FLOAT32_IEEE POSTRG_CM_single_1 0 0 -3.4E+38 3.4E+38 LAYOUT COLUMN_DIR MATRIX_DIM 6 ECU_ADDRESS 0x0000 /* @ECU_Address@MotPosnTrig@ */ /end MEASUREMENT
/begin MEASUREMENT MotSpd "The mechanical motor speed" SWORD POSINP_CM_int16_rpm 0 0 -32768 32767 ECU_ADDRESS 0x0000 /* @ECU_Address@MotSpd@ */ /end MEASUREMENT
/begin MEASUREMENT MotSpdCmd "The motor speed command the controller is controlling to" SWORD SPDCTL_CM_int16_rpm 0 0 -32768 32767 ECU_ADDRESS 0x0000 /* @ECU_Address@MotSpdCmd@ */ /end MEASUREMENT
/begin MEASUREMENT MotSpdMag "The magnetic motor speed" FLOAT32_IEEE POSINP_CM_single_rad_per_s 0 0 -3.4E+38 3.4E+38 ECU_ADDRESS 0x0000 /* @ECU_Address@MotSpdMag@ */ /end MEASUREMENT
/begin MEASUREMENT MotSpdReqCan "The requested motor speed" SWORD MEDINP_CM_int16_rpm 0 0 -32768 32767 ECU_ADDRESS 0x0000 /* @ECU_Address@MotSpdReqCan@ */ /end MEASUREMENT
/begin MEASUREMENT MotTqCmd "The commanded motor torque after arbitration and limitations" FLOAT32_IEEE TRQCTL_CM_single_N_into_m 0 0 -3.4E+38 3.4E+38 ECU_ADDRESS 0x0000 /* @ECU_Address@MotTqCmd@ */ /end MEASUREMENT
/begin MEASUREMENT MotTqCmdSpdCtl "The motor torque commanded by the motor speed controller" FLOAT32_IEEE SPDCTL_CM_single_N_into_m 0 0 -3.4E+38 3.4E+38 ECU_ADDRESS 0x0000 /* @ECU_Address@MotTqCmdSpdCtl@ */ /end MEASUREMENT
/begin MEASUREMENT MotTqMax "The maximum motor torque after derates" FLOAT32_IEEE TRQCTL_CM_single_N_into_m 0 0 -3.4E+38 3.4E+38 ECU_ADDRESS 0x0000 /* @ECU_Address@MotTqMax@ */ /end MEASUREMENT
/begin MEASUREMENT MotTqReqCan "The requested motor torque" FLOAT32_IEEE MEDINP_CM_single_N_into_m 0 0 -3.4E+38 3.4E+38 ECU_ADDRESS 0x0000 /* @ECU_Address@MotTqReqCan@ */ /end MEASUREMENT
/begin MEASUREMENT PhaCurA "Phase A current" FLOAT32_IEEE ADCINP_CM_single_A 0 0 -3.4E+38 3.4E+38 ECU_ADDRESS 0x0000 /* @ECU_Address@PhaCurA@ */ /end MEASUREMENT
/begin MEASUREMENT PhaCurB "Phase B current" FLOAT32_IEEE ADCINP_CM_single_A 0 0 -3.4E+38 3.4E+38 ECU_ADDRESS 0x0000 /* @ECU_Address@PhaCurB@ */ /end MEASUREMENT
/begin MEASUREMENT PhaCurC "Phase C current" FLOAT32_IEEE ADCINP_CM_single_A 0 0 -3.4E+38 3.4E+38 ECU_ADDRESS 0x0000 /* @ECU_Address@PhaCurC@ */ /end MEASUREMENT
/begin MEASUREMENT PhaCurD "The motor current in the rotating d axis direction (non-torque producing)." FLOAT32_IEEE CLAPAR_CM_single_A 0 0 -3.4E+38 3.4E+38 ECU_ADDRESS 0x0000 /* @ECU_Address@PhaCurD@ */ /end MEASUREMENT
/begin MEASUREMENT PhaCurDTar "The target d-axis current" FLOAT32_IEEE TRQCTL_CM_single_A 0 0 -3.4E+38 3.4E+38 ECU_ADDRESS 0x0000 /* @ECU_Address@PhaCurDTar@ */ /end MEASUREMENT
/begin MEASUREMENT PhaCurQ "The motor current in the rotating q axis direction (torque producing)." FLOAT32_IEEE CLAPAR_CM_single_A 0 0 -3.4E+38 3.4E+38 ECU_ADDRESS 0x0000 /* @ECU_Address@PhaCurQ@ */ /end MEASUREMENT
/begin MEASUREMENT PhaCurQTar "The target q-axis current" FLOAT32_IEEE TRQCTL_CM_single_A 0 0 -3.4E+38 3.4E+38 ECU_ADDRESS 0x0000 /* @ECU_Address@PhaCurQTar@ */ /end MEASUREMENT
/begin MEASUREMENT PhaUA "" FLOAT32_IEEE ADCINP_CM_single_V 0 0 -3.4E+38 3.4E+38 ECU_ADDRESS 0x0000 /* @ECU_Address@PhaUA@ */ /end MEASUREMENT
/begin MEASUREMENT PhaUACmd "Phase A voltage command" FLOAT32_IEEE INVCPA_CM_single_V 0 0 -3.4E+38 3.4E+38 ECU_ADDRESS 0x0000 /* @ECU_Address@PhaUACmd@ */ /end MEASUREMENT
/begin MEASUREMENT PhaUB "" FLOAT32_IEEE ADCINP_CM_single_V 0 0 -3.4E+38 3.4E+38 ECU_ADDRESS 0x0000 /* @ECU_Address@PhaUB@ */ /end MEASUREMENT
/begin MEASUREMENT PhaUBCmd "Phase B voltage command" FLOAT32_IEEE INVCPA_CM_single_V 0 0 -3.4E+38 3.4E+38 ECU_ADDRESS 0x0000 /* @ECU_Address@PhaUBCmd@ */ /end MEASUREMENT
/begin MEASUREMENT PhaUC "" FLOAT32_IEEE ADCINP_CM_single_V 0 0 -3.4E+38 3.4E+38 ECU_ADDRESS 0x0000 /* @ECU_Address@PhaUC@ */ /end MEASUREMENT
/begin MEASUREMENT PhaUCCmd "Phase C voltage command" FLOAT32_IEEE INVCPA_CM_single_V 0 0 -3.4E+38 3.4E+38 ECU_ADDRESS 0x0000 /* @ECU_Address@PhaUCCmd@ */ /end MEASUREMENT
/begin MEASUREMENT PhaUDCmd "Commanded d-axis phase voltage" FLOAT32_IEEE CURCTL_CM_single_V 0 0 -3.4E+38 3.4E+38 ECU_ADDRESS 0x0000 /* @ECU_Address@PhaUDCmd@ */ /end MEASUREMENT
/begin MEASUREMENT PhaUQCmd "Commanded q-axis phase voltage" FLOAT32_IEEE CURCTL_CM_single_V 0 0 -3.4E+38 3.4E+38 ECU_ADDRESS 0x0000 /* @ECU_Address@PhaUQCmd@ */ /end MEASUREMENT
/begin MEASUREMENT PwrCmd "The command to activate the auxilary power supplies" UBYTE MODCTL_CM_boolean_1 0 0 0 1 ECU_ADDRESS 0x0000 /* @ECU_Address@PwrCmd@ */ /end MEASUREMENT
/begin MEASUREMENT ResolverSinCos "Resolver sine and cosine signals." FLOAT32_IEEE ADCINP_CM_single_1 0 0 -3.4E+38 3.4E+38 LAYOUT COLUMN_DIR MATRIX_DIM 2 ECU_ADDRESS 0x0000 /* @ECU_Address@ResolverSinCos@ */ /end MEASUREMENT
/begin AXIS_PTS MotTqGainBdT1_Ax "The axis for the table that maps between the board temperature and the gain that limits the maximum motor torque" 0x0000 /* @ECU_Address@MotTqGainBdT1_Ax@ */ NO_INPUT_QUANTITY Axis_FLOAT32_IEEE 0 P2319ASW01_CM_single_degC 5 -40.000000 250.000000 /end AXIS_PTS
/begin AXIS_PTS MotTqGainBdT2_Ax "The axis for the table that maps between the board temperature and the gain that limits the maximum motor torque" 0x0000 /* @ECU_Address@MotTqGainBdT2_Ax@ */ NO_INPUT_QUANTITY Axis_FLOAT32_IEEE 0 P2319ASW01_CM_single_degC 5 -40.000000 250.000000 /end AXIS_PTS
/begin AXIS_PTS MotTqMaxMotSpd_Ax "The axis values for the table that maps between the motor speed and the maximum motor torque" 0x0000 /* @ECU_Address@MotTqMaxMotSpd_Ax@ */ NO_INPUT_QUANTITY Axis_FLOAT32_IEEE 0 P2319ASW01_CM_single_rpm 5 0.000000 32000.000000 /end AXIS_PTS
/begin COMPU_METHOD ADCINP_CM_single_1 "Q = V" IDENTICAL "%8.6" "1" /end COMPU_METHOD
/begin COMPU_METHOD ADCINP_CM_single_A "Q = V" IDENTICAL "%8.6" "A" /end COMPU_METHOD
/begin COMPU_METHOD ADCINP_CM_single_V "Q = V" IDENTICAL "%8.6" "V" /end COMPU_METHOD
/begin COMPU_METHOD CLAPAR_CM_single_A "Q = V" IDENTICAL "%8.6" "A" /end COMPU_METHOD
/begin COMPU_METHOD CURCTL_CM_single_V "Q = V" IDENTICAL "%8.6" "V" /end COMPU_METHOD
/begin COMPU_METHOD GATOUP_CM_uint16_1 "Q = V" IDENTICAL "%5.0" "1" /end COMPU_METHOD
/begin COMPU_METHOD INVCPA_CM_single_V "Q = V" IDENTICAL "%8.6" "V" /end COMPU_METHOD
/begin COMPU_METHOD MEDINP_CM_DRIVEMODE_1 "Enumerated data type: DRIVEMODE" TAB_VERB "%0.6" "1" COMPU_TAB_REF VTAB_FOR_MEDINP_CM_DRIVEMODE_1 /end COMPU_METHOD
/begin COMPU_VTAB VTAB_FOR_MEDINP_CM_DRIVEMODE_1 "Enumerated data type: DRIVEMODE" TAB_VERB 4 0 "DISABLED" 1 "TQ_CTRL" 2 "SPD_CTRL" 3 "OPEN_LOOP" /end COMPU_VTAB
/begin COMPU_METHOD MEDINP_CM_int16_rpm "Q = V" IDENTICAL "%5.0" "rpm" /end COMPU_METHOD
/begin COMPU_METHOD MEDINP_CM_single_N_into_m "Q = V" IDENTICAL "%8.6" "N*m" /end COMPU_METHOD
/begin COMPU_METHOD MEDOUP_CM_uint8_1 "Q = V" IDENTICAL "%3.0" "1" /end COMPU_METHOD
/begin COMPU_METHOD MODCTL_CM_DRIVEMODE_1 "Enumerated data type: DRIVEMODE" TAB_VERB "%0.6" "1" COMPU_TAB_REF VTAB_FOR_MODCTL_CM_DRIVEMODE_1 /end COMPU_METHOD
/begin COMPU_VTAB VTAB_FOR_MODCTL_CM_DRIVEMODE_1 "Enumerated data type: DRIVEMODE" TAB_VERB 4 0 "DISABLED" 1 "TQ_CTRL" 2 "SPD_CTRL" 3 "OPEN_LOOP" /end COMPU_VTAB
/begin COMPU_METHOD MODCTL_CM_boolean_1 "Q = V" IDENTICAL "%1.0" "1" /end COMPU_METHOD
/begin COMPU_METHOD P2319ASW01_CM_DRIVEMODE_1 "Enumerated data type: DRIVEMODE" TAB_VERB "%0.6" "1" COMPU_TAB_REF VTAB_FOR_P2319ASW01_CM_DRIVEMODE_1 /end COMPU_METHOD
/begin COMPU_VTAB VTAB_FOR_P2319ASW01_CM_DRIVEMODE_1 "Enumerated data type: DRIVEMODE" TAB_VERB 4 0 "DISABLED" 1 "TQ_CTRL" 2 "SPD_CTRL" 3 "OPEN_LOOP" /end COMPU_VTAB
/begin COMPU_METHOD P2319ASW01_CM_boolean_1 "Q = V" IDENTICAL "%1.0" "1" /end COMPU_METHOD
/begin COMPU_METHOD P2319ASW01_CM_int16_1 "Q = V" IDENTICAL "%5.0" "1" /end COMPU_METHOD
/begin COMPU_METHOD P2319ASW01_CM_int16_rpm "Q = V" IDENTICAL "%5.0" "rpm" /end COMPU_METHOD
/begin COMPU_METHOD P2319ASW01_CM_logical_1 "Q = V" IDENTICAL "%1.0" "1" /end COMPU_METHOD
/begin COMPU_METHOD P2319ASW01_CM_single_1 "Q = V" IDENTICAL "%8.6" "1" /end COMPU_METHOD
/begin COMPU_METHOD P2319ASW01_CM_single_1_per_V "Q = V" IDENTICAL "%8.6" "1/V" /end COMPU_METHOD
/begin COMPU_METHOD P2319ASW01_CM_single_1_per_s "Q = V" IDENTICAL "%8.6" "1/s" /end COMPU_METHOD
/begin COMPU_METHOD P2319ASW01_CM_single_1_per_s_2 "Q = V" IDENTICAL "%8.6" "1/s^2" /end COMPU_METHOD
/begin COMPU_METHOD P2319ASW01_CM_single_A "Q = V" IDENTICAL "%8.6" "A" /end COMPU_METHOD
/begin COMPU_METHOD P2319ASW01_CM_single_A_per_1 "Q = V" IDENTICAL "%8.6" "A/1" /end COMPU_METHOD
/begin COMPU_METHOD P2319ASW01_CM_single_H "Q = V" IDENTICAL "%8.6" "H" /end COMPU_METHOD
/begin COMPU_METHOD P2319ASW01_CM_single_N_into_m "Q = V" IDENTICAL "%8.6" "N*m" /end COMPU_METHOD
/begin COMPU_METHOD P2319ASW01_CM_single_N_into_m_per_A "Q = V" IDENTICAL "%8.6" "N*m/A" /end COMPU_METHOD
/begin COMPU_METHOD P2319ASW01_CM_single_N_into_m_per__rpm_into_sec_ "Q = V" IDENTICAL "%8.6" "N*m/(rpm*sec)" /end COMPU_METHOD
/begin COMPU_METHOD P2319ASW01_CM_single_N_into_m_per_rpm "Q = V" IDENTICAL "%8.6" "N*m/rpm" /end COMPU_METHOD
/begin COMPU_METHOD P2319ASW01_CM_single_V "Q = V" IDENTICAL "%8.6" "V" /end COMPU_METHOD
/begin COMPU_METHOD P2319ASW01_CM_single_V_into_s "Q = V" IDENTICAL "%8.6" "V*s" /end COMPU_METHOD
/begin COMPU_METHOD P2319ASW01_CM_single_V_per_1 "Q = V" IDENTICAL "%8.6" "V/1" /end COMPU_METHOD
/begin COMPU_METHOD P2319ASW01_CM_single_V_per_A "Q = V" IDENTICAL "%8.6" "V/A" /end COMPU_METHOD
/begin COMPU_METHOD P2319ASW01_CM_single_V_per__A_into_s_ "Q = V" IDENTICAL "%8.6" "V/(A*s)" /end COMPU_METHOD
/begin COMPU_METHOD P2319ASW01_CM_single_degC "Q = V" IDENTICAL "%8.6" "degC" /end COMPU_METHOD
/begin COMPU_METHOD P2319ASW01_CM_single_degC_per_1 "Q = V" IDENTICAL "%8.6" "degC/1" /end COMPU_METHOD
/begin COMPU_METHOD P2319ASW01_CM_single_rad "Q = V" IDENTICAL "%8.6" "rad" /end COMPU_METHOD
/begin COMPU_METHOD P2319ASW01_CM_single_rad_per_s "Q = V" IDENTICAL "%8.6" "rad/s" /end COMPU_METHOD
/begin COMPU_METHOD P2319ASW01_CM_single_rpm "Q = V" IDENTICAL "%8.6" "rpm" /end COMPU_METHOD
/begin COMPU_METHOD P2319ASW01_CM_single_rpm_per_sec "Q = V" IDENTICAL "%8.6" "rpm/sec" /end COMPU_METHOD
/begin COMPU_METHOD P2319ASW01_CM_single_s "Q = V" IDENTICAL "%8.6" "s" /end COMPU_METHOD
/begin COMPU_METHOD P2319ASW01_CM_uint16_1 "Q = V" IDENTICAL "%5.0" "1" /end COMPU_METHOD
/begin COMPU_METHOD P2319ASW01_CM_uint16_rpm "Q = V" IDENTICAL "%5.0" "rpm" /end COMPU_METHOD
/begin COMPU_METHOD P2319ASW01_CM_uint8_1 "Q = V" IDENTICAL "%3.0" "1" /end COMPU_METHOD
/begin COMPU_METHOD POSINP_CM_int16_rpm "Q = V" IDENTICAL "%5.0" "rpm" /end COMPU_METHOD
/begin COMPU_METHOD POSINP_CM_single_rad "Q = V" IDENTICAL "%8.6" "rad" /end COMPU_METHOD
/begin COMPU_METHOD POSINP_CM_single_rad_per_s "Q = V" IDENTICAL "%8.6" "rad/s" /end COMPU_METHOD
/begin COMPU_METHOD POSTRG_CM_single_1 "Q = V" IDENTICAL "%8.6" "1" /end COMPU_METHOD
/begin COMPU_METHOD SLWINP_CM_boolean_1 "Q = V" IDENTICAL "%1.0" "1" /end COMPU_METHOD
/begin COMPU_METHOD SLWINP_CM_single_V "Q = V" IDENTICAL "%8.6" "V" /end COMPU_METHOD
/begin COMPU_METHOD SLWINP_CM_single_degC "Q = V" IDENTICAL "%8.6" "degC" /end COMPU_METHOD
/begin COMPU_METHOD SLWOUP_CM_boolean_1 "Q = V" IDENTICAL "%1.0" "1" /end COMPU_METHOD
/begin COMPU_METHOD SLWOUP_CM_uint8_1 "Q = V" IDENTICAL "%3.0" "1" /end COMPU_METHOD
/begin COMPU_METHOD SPDCTL_CM_int16_rpm "Q = V" IDENTICAL "%5.0" "rpm" /end COMPU_METHOD
/begin COMPU_METHOD SPDCTL_CM_single_N_into_m "Q = V" IDENTICAL "%8.6" "N*m" /end COMPU_METHOD
/begin COMPU_METHOD TRQCTL_CM_single_A "Q = V" IDENTICAL "%8.6" "A" /end COMPU_METHOD
/begin COMPU_METHOD TRQCTL_CM_single_N_into_m "Q = V" IDENTICAL "%8.6" "N*m" /end COMPU_METHOD
/begin RECORD_LAYOUT Record_BOOLEAN FNC_VALUES 1 UBYTE COLUMN_DIR DIRECT /end RECORD_LAYOUT
/begin RECORD_LAYOUT Record_FLOAT32_IEEE FNC_VALUES 1 FLOAT32_IEEE COLUMN_DIR DIRECT /end RECORD_LAYOUT
/begin RECORD_LAYOUT Record_SWORD FNC_VALUES 1 SWORD COLUMN_DIR DIRECT /end RECORD_LAYOUT
/begin RECORD_LAYOUT Record_UBYTE FNC_VALUES 1 UBYTE COLUMN_DIR DIRECT /end RECORD_LAYOUT
/begin RECORD_LAYOUT Record_UWORD FNC_VALUES 1 UWORD COLUMN_DIR DIRECT /end RECORD_LAYOUT
/* Record Layouts for Lookup Tables in Standard Axis format */
/begin RECORD_LAYOUT Axis_FLOAT32_IEEE AXIS_PTS_X 1 FLOAT32_IEEE INDEX_INCR DIRECT /end RECORD_LAYOUT
/begin GROUP P2319ASW01 "P2319ASW01" /* Root */ ROOT
 /begin SUB_GROUP P2319ASW01_Current_Control P2319ASW01_Supervisor P2319ASW01_Torque_Speed_Control /end SUB_GROUP
/end GROUP
/begin GROUP P2319ASW01_105_CLAPAR_Model "P2319ASW01/Current_Control/CLAPAR/Model" /begin REF_MEASUREMENT PhaCurD PhaCurQ /end REF_MEASUREMENT /end GROUP
/begin GROUP P2319ASW01_116_CURCTL_Model "P2319ASW01/Current_Control/CURCTL/Model" /begin REF_MEASUREMENT PhaUDCmd PhaUQCmd /end REF_MEASUREMENT /end GROUP
/begin GROUP P2319ASW01_128_GATOUP_Model "P2319ASW01/Current_Control/GATOUP/Model" /begin REF_MEASUREMENT ASWOUT_PhaAPwmDc ASWOUT_PhaBPwmDc ASWOUT_PhaCPwmDc /end REF_MEASUREMENT /end GROUP
/begin GROUP P2319ASW01_137_INVCPA_Model "P2319ASW01/Current_Control/INVCPA/Model" /begin REF_MEASUREMENT PhaUACmd PhaUBCmd PhaUCCmd /end REF_MEASUREMENT /end GROUP
/begin GROUP P2319ASW01_143_POSINP_Model "P2319ASW01/Current_Control/POSINP/Model" /begin REF_MEASUREMENT ASWIN_EncoderCt ASWIN_EncoderZ MotPosnMag MotSpd MotSpdMag /end REF_MEASUREMENT /end GROUP
/begin GROUP P2319ASW01_153_SPDCTL_Model "P2319ASW01/Torque_Speed_Control/SPDCTL/Model" /begin REF_MEASUREMENT MotTqCmdSpdCtl /end REF_MEASUREMENT /end GROUP
/begin GROUP P2319ASW01_161_TRQCTL_Model "P2319ASW01/Torque_Speed_Control/TRQCTL/Model" /begin SUB_GROUP P2319ASW01_161_TRQCTL_Model_Saturation_Dynamic /end SUB_GROUP /begin REF_MEASUREMENT MotTqMax PhaCurDTar PhaCurQTar /end REF_MEASUREMENT /end GROUP
/begin GROUP P2319ASW01_161_TRQCTL_Model_Saturation_Dynamic "TRQCTL/Saturation\r\nDynamic" /begin REF_MEASUREMENT MotTqMax /end REF_MEASUREMENT /end GROUP
/begin GROUP P2319ASW01_175_MODCTL_Model "P2319ASW01/Supervisor/MODCTL/Model" /begin REF_MEASUREMENT DrvMod PwrCmd /end REF_MEASUREMENT /end GROUP
/begin GROUP P2319ASW01_182_ADCINP_Model "P2319ASW01/Current_Control/ADCINP/Model"
 /begin REF_MEASUREMENT ASWIN_HvBusCur ASWIN_HvBusU ASWIN_PhaCurA ASWIN_PhaCurB ASWIN_PhaCurC ASWIN_PhaUA ASWIN_PhaUB ASWIN_PhaUC ASWIN_ResolverCos ASWIN_ResolverSin HvBusCur HvBusU PhaCurA PhaCurB PhaCurC ResolverSinCos /end REF_MEASUREMENT
/end GROUP
/begin GROUP P2319ASW01_241_POSTRG_Model "P2319ASW01/Current_Control/POSTRG/Model" /begin REF_MEASUREMENT MotPosnTrig /end REF_MEASUREMENT /end GROUP
/begin GROUP P2319ASW01_291_MEDINP_Model "P2319ASW01/Torque_Speed_Control/MEDINP/Model" /begin SUB_GROUP P2319ASW01_291_MEDINP_Model_Detect_Change /end SUB_GROUP
 /begin REF_MEASUREMENT ASWIN_McuReqCt ASWIN_McuReqDa DrvModReq MotSpdReqCan MotTqReqCan /end REF_MEASUREMENT
/end GROUP
/begin GROUP P2319ASW01_291_MEDINP_Model_Detect_Change "MEDINP/Detect\r\nChange" /begin REF_MEASUREMENT ASWIN_McuReqCt /end REF_MEASUREMENT /end GROUP
/begin GROUP P2319ASW01_310_SLWINP_Model "P2319ASW01/Supervisor/SLWINP/Model"
 /begin REF_MEASUREMENT ASWIN_AuxPwrSts ASWIN_BdT1 ASWIN_BdT2 ASWIN_MaiPwrSts ASWIN_McuT ASWIN_McuUBat ASWIN_McuURef AuxPwrAcv BdT1 BdT2 MaiPwrAcv McuT /end REF_MEASUREMENT
/end GROUP
/begin GROUP P2319ASW01_322_SLWOUP_Model "P2319ASW01/Supervisor/SLWOUP/Model"
 /begin REF_MEASUREMENT ASWOUT_CanPwrPwmEna ASWOUT_GreenLed ASWOUT_InPwrPwmEna ASWOUT_McuData2Da ASWOUT_MtrPwrPwmEna ASWOUT_PhaPwmEna ASWOUT_RedLed ASWOUT_ResolverExctEna ASWOUT_SwPwrPwmEna ASWOUT_YellowLed /end REF_MEASUREMENT
/end GROUP
/begin GROUP P2319ASW01_328_MEDOUP_Model "P2319ASW01/Torque_Speed_Control/MEDOUP/Model" /begin REF_MEASUREMENT ASWOUT_McuData1Da /end REF_MEASUREMENT /end GROUP
/begin GROUP P2319ASW01_Current_Control "P2319ASW01/Current_Control"
 /begin SUB_GROUP P2319ASW01_Current_Control_ADCINP P2319ASW01_Current_Control_CLAPAR P2319ASW01_Current_Control_CURCTL P2319ASW01_Current_Control_GATOUP P2319ASW01_Current_Control_INVCPA P2319ASW01_Current_Control_POSINP P2319ASW01_Current_Control_POSTRG /end SUB_GROUP
/end GROUP
/begin GROUP P2319ASW01_Current_Control_ADCINP "P2319ASW01/Current_Control/ADCINP"
 /begin REF_CHARACTERISTIC HvBusCurDialEna_C HvBusCurDialVal_C HvBusCurFilTiCon_C HvBusCurGain_C HvBusCurOfs_C HvBusUDialEna_C HvBusUDialVal_C HvBusUFilTiCon_C HvBusUGain_C HvBusUOfs_C PhaCurADialEna_C PhaCurADialVal_C PhaCurAFilTiCon_C PhaCurAGain_C PhaCurAOfs_C PhaCurBDialEna_C PhaCurBDialVal_C PhaCurBFilTiCon_C PhaCurBGain_C PhaCurBOfs_C PhaCurCDialEna_C PhaCurCDialVal_C PhaCurCFilTiCon_C PhaCurCGain_C PhaCurCOfs_C PhaUAFilTiCon_C PhaUAGain_C PhaUAOfs_C PhaUBFilTiCon_C PhaUBGain_C PhaUBOfs_C PhaUCFilTiCon_C PhaUCGain_C PhaUCOfs_C ResolverCosFilTiCon_C ResolverCosGain_C ResolverCosOfs_C ResolverSinCosDialEna_C ResolverSinCosDialVal_CA ResolverSinFilTiCon_C ResolverSinGain_C ResolverSinOfs_C /end REF_CHARACTERISTIC
 /begin REF_MEASUREMENT ASWIN_HvBusCur ASWIN_HvBusU ASWIN_PhaCurA ASWIN_PhaCurB ASWIN_PhaCurC ASWIN_PhaUA ASWIN_PhaUB ASWIN_PhaUC ASWIN_ResolverCos ASWIN_ResolverSin HvBusCur HvBusU PhaCurA PhaCurB PhaCurC ResolverSinCos /end REF_MEASUREMENT
/end GROUP
/begin GROUP P2319ASW01_Current_Control_CLAPAR "P2319ASW01/Current_Control/CLAPAR"
 /begin REF_CHARACTERISTIC PhaCurDDialEna_C PhaCurDDialVal_C PhaCurQDialEna_C PhaCurQDialVal_C /end REF_CHARACTERISTIC
 /begin REF_MEASUREMENT MotPosnTrig PhaCurA PhaCurB PhaCurC PhaCurD PhaCurQ /end REF_MEASUREMENT
/end GROUP
/begin GROUP P2319ASW01_Current_Control_CURCTL "P2319ASW01/Current_Control/CURCTL"
 /begin REF_CHARACTERISTIC FluxLinkage_C PhaUDAntiWindupGain_C PhaUDCmdDialEna_C PhaUDCmdDialVal_C PhaUDCmdOpenLoop_C PhaUDGainI_C PhaUDGainP_C PhaUMaxVal_C PhaUQAntiWindupGain_C PhaUQCmdDialEna_C PhaUQCmdDialVal_C PhaUQCmdOpenLoop_C PhaUQGainI_C PhaUQGainP_C StatorInductanceD_C StatorInductanceQ_C /end REF_CHARACTERISTIC
 /begin REF_MEASUREMENT HvBusU MotSpdMag PhaCurD PhaCurQ PhaUDCmd PhaUQCmd /end REF_MEASUREMENT
/end GROUP
/begin GROUP P2319ASW01_Current_Control_GATOUP "P2319ASW01/Current_Control/GATOUP"
 /begin REF_CHARACTERISTIC PhaAPwmDcDialEna_C PhaAPwmDcDialVal_C PhaBPwmDcDialEna_C PhaBPwmDcDialVal_C PhaCPwmDcDialEna_C PhaCPwmDcDialVal_C ReloadRegisterMax_C /end REF_CHARACTERISTIC
 /begin REF_MEASUREMENT ASWOUT_PhaAPwmDc ASWOUT_PhaBPwmDc ASWOUT_PhaCPwmDc HvBusU PhaUACmd PhaUBCmd PhaUCCmd /end REF_MEASUREMENT
/end GROUP
/begin GROUP P2319ASW01_Current_Control_INVCPA "P2319ASW01/Current_Control/INVCPA"
 /begin REF_CHARACTERISTIC PhaUACmdDialEna_C PhaUACmdDialVal_C PhaUBCmdDialEna_C PhaUBCmdDialVal_C PhaUCCmdDialEna_C PhaUCCmdDialVal_C /end REF_CHARACTERISTIC
 /begin REF_MEASUREMENT MotPosnTrig PhaUACmd PhaUBCmd PhaUCCmd PhaUDCmd PhaUQCmd /end REF_MEASUREMENT
/end GROUP
/begin GROUP P2319ASW01_Current_Control_POSINP "P2319ASW01/Current_Control/POSINP"
 /begin REF_CHARACTERISTIC EncoderCtPerRev_C EncoderOfs_C MotPolePairs_C MotPosnEstimrGainI_C MotPosnEstimrGainP_C MotPosnEstimrIntglEna_C MotPosnMagDialEna_C MotPosnMagDialVal_C MotPosnOfs_C MotPosnSenMeth_C MotSpdDialEna_C MotSpdDialVal_C MotSpdFilTiCon_C MotSpdMagDialEna_C MotSpdMagDialVal_C /end REF_CHARACTERISTIC
 /begin REF_MEASUREMENT ASWIN_EncoderCt ASWIN_EncoderZ MotPosnMag MotSpd MotSpdMag ResolverSinCos /end REF_MEASUREMENT
/end GROUP
/begin GROUP P2319ASW01_Current_Control_POSTRG "P2319ASW01/Current_Control/POSTRG" /begin REF_CHARACTERISTIC MotPosnTrigDialEna_C MotPosnTrigDialVal_CA /end REF_CHARACTERISTIC /begin REF_MEASUREMENT MotPosnMag MotPosnTrig /end REF_MEASUREMENT /end GROUP
/begin GROUP P2319ASW01_Supervisor "P2319ASW01/Supervisor"
 /begin SUB_GROUP P2319ASW01_Supervisor_MODCTL P2319ASW01_Supervisor_SLWINP P2319ASW01_Supervisor_SLWOUP /end SUB_GROUP
/end GROUP
/begin GROUP P2319ASW01_Supervisor_MODCTL "P2319ASW01/Supervisor/MODCTL"
 /begin REF_CHARACTERISTIC DrvModDialEna_C DrvModDialVal_C MotSpdReqThdModChg_C MotSpdThdModChg_C MotTqReqThdModChg_C PwrCmdDialEna_C PwrCmdDialVal_C WakeRetry_C WakeTout_C /end REF_CHARACTERISTIC
 /begin REF_MEASUREMENT AuxPwrAcv DrvMod MaiPwrAcv PwrCmd /end REF_MEASUREMENT
/end GROUP
/begin GROUP P2319ASW01_Supervisor_SLWINP "P2319ASW01/Supervisor/SLWINP"
 /begin REF_CHARACTERISTIC AuxPwrAcvDebFall_C AuxPwrAcvDebRisng_C AuxPwrAcvDialEna_C AuxPwrAcvDialVal_C AuxPwrStsIvt_C BdT1DialEna_C BdT1DialVal_C BdT1FilTiCon_C BdT1Gain_C BdT1Ofs_C BdT2DialEna_C BdT2DialVal_C BdT2FilTiCon_C BdT2Gain_C BdT2Ofs_C MaiPwrAcvDebFall_C MaiPwrAcvDebRisng_C MaiPwrAcvDialEna_C MaiPwrAcvDialVal_C MaiPwrStsIvt_C McuTDialEna_C McuTDialVal_C McuTFilTiCon_C McuTGain_C McuTOfs_C McuUBatFilTiCon_C McuUBatGain_C McuUBatOfs_C McuURefFilTiCon_C McuURefGain_C McuURefOfs_C /end REF_CHARACTERISTIC
 /begin REF_MEASUREMENT ASWIN_AuxPwrSts ASWIN_BdT1 ASWIN_BdT2 ASWIN_MaiPwrSts ASWIN_McuT ASWIN_McuUBat ASWIN_McuURef AuxPwrAcv BdT1 BdT2 MaiPwrAcv McuT /end REF_MEASUREMENT
/end GROUP
/begin GROUP P2319ASW01_Supervisor_SLWOUP "P2319ASW01/Supervisor/SLWOUP"
 /begin REF_CHARACTERISTIC CanPwrPwmEna_C GreenLedDialEna_C GreenLedDialVal_C GreenLedIvt_C InPwrPwmEna_C LedOffTi_C LedPlsCtDft_C LedPlsCtOpenLoop_C LedPlsCtSpdCtl_C LedPlsCtTqCtl_C McuData2DaDialEna_C McuData2DaDialVal_CA MtrPwrPwmEna_C PhaPwmEnaDialEna_C PhaPwmEnaDialVal_C PlsOffTi_C PlsOnTi_C RedLedDialEna_C RedLedDialVal_C RedLedIvt_C ResolverExctEna_C SwPwrPwmEna_C YellowLedCmd_C /end REF_CHARACTERISTIC
 /begin REF_MEASUREMENT ASWOUT_CanPwrPwmEna ASWOUT_GreenLed ASWOUT_InPwrPwmEna ASWOUT_McuData2Da ASWOUT_MtrPwrPwmEna ASWOUT_PhaPwmEna ASWOUT_RedLed ASWOUT_ResolverExctEna ASWOUT_SwPwrPwmEna ASWOUT_YellowLed BdT1 BdT2 DrvMod McuT PwrCmd /end REF_MEASUREMENT
/end GROUP
/begin GROUP P2319ASW01_Torque_Speed_Control "P2319ASW01/Torque_Speed_Control"
 /begin SUB_GROUP P2319ASW01_Torque_Speed_Control_MEDINP P2319ASW01_Torque_Speed_Control_MEDOUP P2319ASW01_Torque_Speed_Control_SPDCTL P2319ASW01_Torque_Speed_Control_TRQCTL /end SUB_GROUP
/end GROUP
/begin GROUP P2319ASW01_Torque_Speed_Control_MEDINP "P2319ASW01/Torque_Speed_Control/MEDINP"
 /begin REF_CHARACTERISTIC DrvModReqDft_C DrvModReqDialEna_C DrvModReqDialVal_C McuReqTout_C MotSpdReqCanDft_C MotSpdReqCanDialEna_C MotSpdReqCanDialVal_C MotTqReqCanDft_C MotTqReqCanDialEna_C MotTqReqCanDialVal_C /end REF_CHARACTERISTIC
 /begin REF_MEASUREMENT ASWIN_McuReqCt ASWIN_McuReqDa DrvModReq MotSpdReqCan MotTqReqCan /end REF_MEASUREMENT
/end GROUP
/begin GROUP P2319ASW01_Torque_Speed_Control_MEDOUP "P2319ASW01/Torque_Speed_Control/MEDOUP" /begin REF_CHARACTERISTIC McuData1DaDialEna_C McuData1DaDialVal_CA /end REF_CHARACTERISTIC /begin REF_MEASUREMENT ASWOUT_McuData1Da /end REF_MEASUREMENT /end GROUP
/begin GROUP P2319ASW01_Torque_Speed_Control_SPDCTL "P2319ASW01/Torque_Speed_Control/SPDCTL"
 /begin REF_CHARACTERISTIC MotSpdRateLim_C MotSpdReqMax_C MotTqCmdSpdCtlDialEna_C MotTqCmdSpdCtlDialVal_C MotTqGainI_C MotTqGainP_C /end REF_CHARACTERISTIC
 /begin REF_MEASUREMENT MotSpdReqCan MotTqCmdSpdCtl MotTqMax /end REF_MEASUREMENT
/end GROUP
/begin GROUP P2319ASW01_Torque_Speed_Control_TRQCTL "P2319ASW01/Torque_Speed_Control/TRQCTL"
 /begin REF_CHARACTERISTIC MotTqCon_C MotTqMaxDialEna_C MotTqMaxDialVal_C PhaCurDTarVal_C PhaCurQTarDialEna_C PhaCurQTarDialVal_C /end REF_CHARACTERISTIC
 /begin REF_MEASUREMENT MotTqCmdSpdCtl MotTqMax MotTqReqCan PhaCurDTar PhaCurQTar /end REF_MEASUREMENT
/end GROUP
/end MODULE
/end PROJECT
/* (add any file trailer comments here) */
/* EOF P2319ASW01.a2l*/
